# MCXN947_cm33_core0 register map
Vendor: nxp.com; File version: 1.0
CPU: CM33 r2p0, little endian, MPU, FPU, VTOR, 3 interrupt priority bits
Registers are 32-bit, read-write, reset 0x0 unless marked. A register's access mark holds for its fields unless they carry their own. Offsets are from the block's base; [hi:lo] are bit positions; {n}, {i} and the like mark numbered series; 'fields as' and 'values as' point back to an identical list.

## INPUTMUX0 (part 1 of 2) — INPUTMUX
Base 0x40006000
{0x0+4i} SCT0_INMUX[{i}] (i=0..7) reset 0x7F — Inputmux Register for SCT0 Input
  [6:0] INP — Input number to SCT0 inputs.
    {v}=SCT0_IN{v} input is selected (v=0..7); {v}=CTIMER{v-8}_MAT0 input is selected (v=8..12); 13=ADC0 ADC0_IRQ input is selected; 14=PINT GPIO_INT_BMAT input is selected; 15=usb0 start of frame input is selected; 16=usb1 start of frame input is selected; {v}=SINC Filter CH{v-17} Conversion Complete input is selected (v=17..21); 22=ARM_TXEV (CM33 event output) input is selected; 23=DEBUG_HALTED input is selected; 24=ADC1_IRQ input is selected; {v}=ADC0_tcomp[{v-25}] input is selected (v=25..28); {v}=ADC1_tcomp[{v-29}] input is selected (v=29..32); 33=CMP0_OUT input is selected; 34=CMP1_OUT input is selected; 35=CMP2_OUT input is selected; {v}=PWM0_A{v-36}_TRIG0/PWM0_A{v-36}_TRIG1 input is selected (v=36..39); {v}=PWM1_A{v-40}_TRIG0/PWM1_A{v-40}_TRIG1 input is selected (v=40..43); 44=ENC0_CMP/POS_MATCH input is selected; 45=ENC1_CMP/POS_MATCH input is selected; 46=EVTG_OUT0A input is selected; 47=EVTG_OUT0B input is selected; 48=EVTG_OUT1A input is selected; 49=EVTG_OUT1B input is selected; 50=EVTG_OUT2A input is selected; 51=EVTG_OUT2B input is selected; 52=EVTG_OUT3A input is selected; 53=EVTG_OUT3B input is selected; 54=FC3_P0 (SDO, RXD, SDA) input is selected; 55=FC3_P1 (SCK, TXD, SCL)) input is selected; 56=FC3_P2 (SDI, RTS, SCLS, TXD) input is selected; 57=FC3_P3 (PCS[0], CTS, SDAS, RXD) input is selected; 60=LP_FLEXCOMM0 trig 0 (lpuart_trg_txword) input is selected; 61=LP_FLEXCOMM0 trig 1 (lpuart_trg_rxword) input is selected; 62=LP_FLEXCOMM0 trig 2 (lpuart_trg_rxidle) input is selected; 63=LP_FLEXCOMM1 trig 0 input is selected; 64=LP_FLEXCOMM1 trig 1 input is selected; 65=LP_FLEXCOMM1 trig 2 input is selected; 66=LP_FLEXCOMM2 trig 0 input is selected; 67=LP_FLEXCOMM2 trig 1 input is selected; 68=LP_FLEXCOMM2 trig 2 input is selected; {v}=LP_FLEXCOMM3 trig {v-69} input is selected (v=69..72); 73=SAI0 TX BCLK input is selected; 74=SAI0 RX BCLK input is selected; 75=SAI1 TX BCLK input is selected; 76=SAI1 RX BCLK input is selected
{0x20+4i} CTIMER0CAP{i} reset 0x7F (i=0..3) — Capture Select Register for CTIMER Inputs
  [6:0] INP — Input number for CTIMER0
    {v}=CT_INP{v} input is selected (v=0..19); 20=usb0 start of frame input is selected; 21=usb1 start of frame input is selected; 22=DCDC_BURST_ACTIVE input is selected; 23=sai0_tx_sync_out input is selected; 24=sai0_rx_sync_out input is selected; 25=ADC0_IRQ input is selected; 26=ADC1_IRQ input is selected; 27=CMP0_OUT input is selected; 28=CMP1_OUT input is selected; 29=CMP2_OUT input is selected; {v}=PWM0_A{v-30}_TRIG0/PWM0_A{v-30}_TRIG1 input is selected (v=30..33); {v}=PWM1_A{v-34}_TRIG0/PWM1_A{v-34}_TRIG1 input is selected (v=34..37); 38=ENC0_CMP/POS_MATCH input is selected; 39=ENC1_CMP/POS_MATCH input is selected; 40=EVTG_OUT0A input is selected; 41=EVTG_OUT0B input is selected; 42=EVTG_OUT1A input is selected; 43=EVTG_OUT1B input is selected; 44=EVTG_OUT2A input is selected; 45=EVTG_OUT2B input is selected; 46=EVTG_OUT3A input is selected; 47=EVTG_OUT3B input is selected; 50=LP_FLEXCOMM0 trig 0 input is selected; 51=LP_FLEXCOMM0 trig 1 input is selected; 52=LP_FLEXCOMM0 trig 2 input is selected; 53=LP_FLEXCOMM1 trig 0 input is selected; 54=LP_FLEXCOMM1 trig 1 input is selected; 55=LP_FLEXCOMM1 trig 2 input is selected; 56=LP_FLEXCOMM2 trig 0 input is selected; 57=LP_FLEXCOMM2 trig 1 input is selected; 58=LP_FLEXCOMM2 trig 2 input is selected; {v}=LP_FLEXCOMM3 trig {v-59} input is selected (v=59..62); 63=sai1_tx_sync_out input is selected; 64=sai1_rx_sync_out input is selected
{0x30+0x20*i} TIMER{i}TRIG reset 0x7F (i=0..2) — Trigger Register for TIMER
  fields as CTIMER0CAP0
{0x40+4i} CTIMER1CAP{i} reset 0x7F (i=0..3) — Capture Select Register for CTIMER Inputs
  fields as CTIMER0CAP0
{0x60+4i} CTIMER2CAP{i} reset 0x7F (i=0..3) — Capture Select Register for CTIMER Inputs
  fields as CTIMER0CAP0
{0xA0+4i} SMARTDMAARCHB_INMUX[{i}] (i=0..7) reset 0x7F — Inputmux Register for SMARTDMA Arch B Inputs
  [6:0] INP — Input number select to SmartDMA ARCHB input
    {v}=GPIO P0_{v} input is selected (v=0..15); 16=SCT0 SCT_OUT8 input is selected; 17=SCT0 SCT_OUT9 input is selected; 20=MRT0 MRT_CH0_IRQ input is selected; 21=MRT0 MRT_CH1_IRQ input is selected; 22=CTIMER4_MAT3 input is selected; 23=CTIMER4_MAT2 input is selected; 24=CTIMER3_MAT3 input is selected; 25=CTIMER3_MAT2 input is selected; 26=CTIMER1_MAT3 input is selected; 27=CTIMER1_MAT2 input is selected; 28=UTICK0 UTICK_IRQ input is selected; 29=WWDT0 WDT0_IRQ input is selected; 30=ADC0 ADC0_IRQ input is selected; 31=CMP0_IRQ input is selected; 32=LPSPI LSPI_HS_IRQ input is selected; 33=LP_FLEXCOMM7_IRQ input is selected; 34=LP_FLEXCOMM6_IRQ input is selected; 35=LP_FLEXCOMM5_IRQ input is selected; 36=LP_FLEXCOMM4_IRQ input is selected; 37=LP_FLEXCOMM3_IRQ input is selected; 38=LP_FLEXCOMM2_IRQ input is selected; 39=LP_FLEXCOMM1_IRQ input is selected; 40=LP_FLEXCOMM0_IRQ input is selected; 41=DMA0_IRQ input is selected; 42=DMA1_IRQ input is selected; 43=SYS_IRQ input is selected; 44=RTC_COMBO_IRQ input is selected; 45=ARM_TXEV input is selected; 46=PINT GPIO_INT_BMATCH input is selected; 49=CMP0_OUT input is selected; 50=usb0 start of frame input is selected; 51=usb1 start of frame input is selected; 52=OSTIMER0 OS_EVENT_TIMER_IRQ input is selected; 53=ADC1_IRQ input is selected; 54=CMP0_IRQ/CMP1_IRQ/CMP2_IRQ input is selected; 55=DAC0_IRQ input is selected; 56=DAC1_IRQ/DAC2_IRQ input is selected; 57=PWM0_IRQ input is selected; 58=PWM1_IRQ input is selected; 59=ENC0_IRQ input is selected; 60=ENC1_IRQ input is selected; 61=EVTG_OUT0A input is selected; 62=EVTG_OUT1A input is selected; 65=GPIO1_alias0 GPIO1 Pin Event Trig 0 input is selected; 66=GPIO1_alias1 GPIO1 Pin Event Trig 1 input is selected; 67=GPIO2_alias0 GPIO2 Pin Event Trig 0 input is selected; 68=GPIO2_alias1 GPIO2 Pin Event Trig 1 input is selected; 69=GPIO3_alias0 GPIO3 Pin Event Trig 0 input is selected; 70=GPIO3_alias1 GPIO3 Pin Event Trig 1 input is selected
{0xC0+4i} PINTSEL[{i}] (i=0..7) reset 0x7F — Pin Interrupt Select
  [6:0] INP — Pin number select for pin interrupt or pattern match engine input. For PIOx_y: INP = (x * 32) + y. PIO0_0 to PIO1_31 correspond to numbers 0 to 63.
    {v}=GPIO P0_{v} input is selected (v=0..31); {v}=GPIO P1_{v-32} input is selected (v=32..55); 62=GPIO P1_30 input is selected; 63=GPIO P1_31 input is selected
0x180 FREQMEAS_REF reset 0x3F — Selection for Frequency Measurement Reference Clock
  [5:0] INP — Clock source number (binary value) for frequency measure function target clock.
    0=clk_in (output of clk_in or XTAL mux in Clockgen) input is selected; 1=FRO_12M input is selected; 2=FRO_144M input is selected; 4=OSC_32K input is selected; 5=CPU/system_clk input is selected; 6=FREQME_CLK_IN0 input is selected; 7=FREQME_CLK_IN1 input is selected; 8=EVTG_OUT0A input is selected; 9=EVTG_OUT1A input is selected
0x184 FREQMEAS_TAR reset 0x3F — Selection for Frequency Measurement Target Clock
  fields as FREQMEAS_REF
{0x1A0+4i} CTIMER3CAP{i} reset 0x7F (i=0..3) — Capture Select Register for CTIMER Inputs
  [6:0] INP — Input number for CTIMER0
    {v}=CT_INP{v} input is selected (v=0..19); 20=usb0 start of frame input is selected; 21=usb1 start of frame input is selected; 22=DCDC_BURST_ACTIVE input is selected; 23=sai0_tx_sync_out input is selected; 24=sai0_rx_sync_out input is selected; 25=ADC0 ADC0_IRQ input is selected; 26=ADC0 ADC1_IRQ input is selected; 27=CMP0_OUT input is selected; 28=CMP1_OUT input is selected; 29=CMP2_OUT input is selected; {v}=PWM0_A{v-30}_TRIG0/PWM0_A{v-30}_TRIG1 input is selected (v=30..33); {v}=PWM1_A{v-34}_TRIG0/PWM1_A{v-34}_TRIG1 input is selected (v=34..37); 38=ENC0_CMP/POS_MATCH input is selected; 39=ENC1_CMP/POS_MATCH input is selected; 40=EVTG_OUT0A input is selected; 41=EVTG_OUT0B input is selected; 42=EVTG_OUT1A input is selected; 43=EVTG_OUT1B input is selected; 44=EVTG_OUT2A input is selected; 45=EVTG_OUT2B input is selected; 46=EVTG_OUT3A input is selected; 47=EVTG_OUT3B input is selected; 50=LP_FLEXCOMM0 trig 0 input is selected; 51=LP_FLEXCOMM0 trig 1 input is selected; 52=LP_FLEXCOMM0 trig 2 input is selected; 53=LP_FLEXCOMM1 trig 0 input is selected; 54=LP_FLEXCOMM1 trig 1 input is selected; 55=LP_FLEXCOMM1 trig 2 input is selected; 56=LP_FLEXCOMM2 trig 0 input is selected; 57=LP_FLEXCOMM2 trig 1 input is selected; 58=LP_FLEXCOMM2 trig 2 input is selected; {v}=LP_FLEXCOMM3 trig {v-59} input is selected (v=59..62); 63=sai1_tx_sync_out input is selected; 64=sai1_rx_sync_out input is selected
0x1B0 TIMER3TRIG reset 0x7F — Trigger Register for TIMER
  fields as CTIMER3CAP0
{0x1C0+4i} CTIMER4CAP{i} reset 0x7F (i=0..3) — Capture Select Register for CTIMER Inputs
  fields as CTIMER3CAP0
0x1D0 TIMER4TRIG reset 0x7F — Trigger Register for TIMER
  fields as CTIMER3CAP0
0x260 CMP0_TRIG reset 0x3F — CMP0 Input Connections
  [5:0] TRIGIN — CMP0 input trigger
    0=PINT PIN_INT0 input is selected; 1=PINT PIN_INT6 input is selected; 2=SCT_OUT4 input is selected; 3=SCT_OUT5 input is selected; 4=SCT_OUT6 input is selected; 5=CTIMER0_MAT3 input is selected; 6=CTIMER1_MAT3 input is selected; 7=CTIMER2_MAT3 input is selected; 8=CTIMER0_MAT0 input is selected; 9=CTIMER4_MAT0 input is selected; 11=ARM_TXEV input is selected; 12=PINT GPIO_INT_BMAT input is selected; 13=ADC0_tcomp[0] input is selected; 14=ADC1_tcomp[0] input is selected; {v}=PWM0_A{v-17}_TRIG0/PWM0_A{v-17}_TRIG1 input is selected (v=17..20); {v}=PWM1_A{v-21}_TRIG0/PWM1_A{v-21}_TRIG1 input is selected (v=21..24); 25=ENC0_CMP/POS_MATCH input is selected; 26=ENC1_CMP/POS_MATCH input is selected; 27=EVTG_OUT0A input is selected; 28=EVTG_OUT0B input is selected; 29=EVTG_OUT1A input is selected; 30=EVTG_OUT1B input is selected; 31=EVTG_OUT2A input is selected; 32=EVTG_OUT2B input is selected; 33=EVTG_OUT3A input is selected; 34=EVTG_OUT3B input is selected; 35=LPTMR0 input is selected; 36=LPTMR1 input is selected; 37=GPIO2 Pin Event Trig 0 input is selected; 38=GPIO2 Pin Event Trig 1 input is selected; 39=GPIO3 Pin Event Trig 0 input is selected; 40=GPIO3 Pin Event Trig 1 input is selected
{0x280+4i} ADC0_TRIG[{i}] (i=0..3) reset 0x7F — ADC Trigger Input Connections
  [7:0] TRIGIN — ADC0 trigger inputs
    0=PINT PIN_INT0 input is selected; 1=PINT PIN_INT1 input is selected; 2=SCT0 SCT_OUT4 input is selected; 3=SCT0 SCT_OUT5 input is selected; 4=SCT0 SCT_OUT9 input is selected; {v}=CTIMER{v-5}_MAT3 input is selected (v=5..9); 10=DCDC_Burst_Done_Trig input is selected; 11=ARM_TXEV input is selected; 12=PINT GPIO_INT_BMAT input is selected; {v}=ADC0_tcomp[{v-13}] input is selected (v=13..16); {v}=ADC1_tcomp[{v-17}] input is selected (v=17..20); 21=CMP0_OUT input is selected; 22=CMP1_OUT input is selected; 23=CMP2_OUT input is selected; 24=PWM0_A0_TRIG0 input is selected; 25=PWM0_A0_TRIG1 input is selected; 26=PWM0_A1_TRIG0 input is selected; 27=PWM0_A1_TRIG1 input is selected; 28=PWM0_A2_TRIG0 input is selected; 29=PWM0_A2_TRIG1 input is selected; 30=PWM0_A3_TRIG0 input is selected; 31=PWM0_A3_TRIG1 input is selected; 32=PWM1_A0_TRIG0 input is selected; 33=PWM1_A0_TRIG1 input is selected; 34=PWM1_A1_TRIG0 input is selected; 35=PWM1_A1_TRIG1 input is selected; 36=PWM1_A2_TRIG0 input is selected; 37=PWM1_A2_TRIG1 input is selected; 38=PWM1_A3_TRIG0 input is selected; 39=PWM1_A3_TRIG1 input is selected; 40=ENC0_CMP/POS_MATCH input is selected; 41=ENC1_CMP/POS_MATCH input is selected; 42=EVTG_OUT0A input is selected; 43=EVTG_OUT0B input is selected; 44=EVTG_OUT1A input is selected; 45=EVTG_OUT1B input is selected; 46=EVTG_OUT2A input is selected; 47=EVTG_OUT2B input is selected; 48=EVTG_OUT3A input is selected; 49=EVTG_OUT3B input is selected; 50=LPTMR0 input is selected; 51=LPTMR1 input is selected; {v}=FlexIO CH{v-52} input is selected (v=52..55); {v}=SINC Filter CH{v-56} Conversion Complete input is selected (v=56..60); 61=GPIO2 Pin Event Trig 0 input is selected; 62=GPIO2 Pin Event Trig 1 input is selected; 63=GPIO3 Pin Event Trig 0 input is selected; 64=GPIO3 Pin Event Trig 1 input is selected; 65=WUU input is selected
{0x2C0+4i} ADC1_TRIG[{i}] (i=0..3) reset 0x7F — ADC Trigger Input Connections
  [7:0] TRIGIN — ADC0 trigger inputs
    0=PINT PIN_INT0 input is selected; 1=PINT PIN_INT2 input is selected; 2=SCT0 SCT_OUT4 input is selected; 3=SCT0 SCT_OUT5 input is selected; 4=SCT0 SCT_OUT3 input is selected; 5=CTIMER0_MAT3 input is selected; 6=CTIMER1_MAT3 input is selected; 7=CTIMER2_MAT3 input is selected; 8=CTIMER3_MAT2 input is selected; 9=CTIMER4_MAT1 input is selected; 10=DCDC_Burst_Done_Trig input is selected; 11=ARM_TXEV input is selected; 12=PINT GPIO_INT_BMAT input is selected; {v}=ADC0_tcomp[{v-13}] input is selected (v=13..16); {v}=ADC1_tcomp[{v-17}] input is selected (v=17..20); 21=CMP0_OUT input is selected; 22=CMP1_OUT input is selected; 23=CMP2_OUT input is selected; 24=PWM0_A0_TRIG0 input is selected; 25=PWM0_A0_TRIG1 input is selected; 26=PWM0_A1_TRIG0 input is selected; 27=PWM0_A1_TRIG1 input is selected; 28=PWM0_A2_TRIG0 input is selected; 29=PWM0_A2_TRIG1 input is selected; 30=PWM0_A3_TRIG0 input is selected; 31=PWM0_A3_TRIG1 input is selected; 32=PWM1_A0_TRIG0 input is selected; 33=PWM1_A0_TRIG1 input is selected; 34=PWM1_A1_TRIG0 input is selected; 35=PWM1_A1_TRIG1 input is selected; 36=PWM1_A2_TRIG0 input is selected; 37=PWM1_A2_TRIG1 input is selected; 38=PWM1_A3_TRIG0 input is selected; 39=PWM1_A3_TRIG1 input is selected; 40=ENC0_CMP/POS_MATCH input is selected; 41=ENC1_CMP/POS_MATCH input is selected; 42=EVTG_OUT0A input is selected; 43=EVTG_OUT0B input is selected; 44=EVTG_OUT1A input is selected; 45=EVTG_OUT1B input is selected; 46=EVTG_OUT2A input is selected; 47=EVTG_OUT2B input is selected; 48=EVTG_OUT3A input is selected; 49=EVTG_OUT3B input is selected; 50=LPTMR0 input is selected; 51=LPTMR1 input is selected; {v}=FlexIO CH{v-52} input is selected (v=52..55); {v}=SINC Filter CH{v-56} Conversion Complete input is selected (v=56..60); 61=GPIO2 Pin Event Trig 0 input is selected; 62=GPIO2 Pin Event Trig 1 input is selected; 63=GPIO3 Pin Event Trig 0 input is selected; 64=GPIO3 Pin Event Trig 1 input is selected; 65=WUU input is selected
{0x300+0x20*i} DAC{i}_TRIG reset 0x3F (i=0..2) — DAC{i} Trigger Inputs
  [5:0] TRIGIN — DAC{i} trigger input
    0=PINT PIN_INT0 input is selected; 1=PINT PIN_INT{i+3} input is selected; 2=SCT0 SCT_OUT4 input is selected; 3=SCT0 SCT_OUT5 input is selected; 4=SCT0 SCT_OUT{i} input is selected; 5=CTIMER0_MAT3 input is selected; 6=CTIMER1_MAT3 input is selected; 7=CTIMER2_MAT3 input is selected; 8=CTIMER2_MAT{i} input is selected; 9=CTIMER3_MAT{i} input is selected; 11=ARM_TXEV input is selected; 12=PINT GPIO_INT_BMAT input is selected; 13=ADC0_tcomp[{i}] input is selected; 14=ADC1_tcomp[{i}] input is selected; 15=CMP0_OUT input is selected; 16=CMP1_OUT input is selected; 17=CMP2_OUT input is selected; 18=EVTG_OUT0A input is selected; 19=EVTG_OUT0B input is selected; 20=EVTG_OUT1A input is selected; 21=EVTG_OUT1B input is selected; 22=EVTG_OUT2A input is selected; 23=EVTG_OUT2B input is selected; 24=EVTG_OUT3A input is selected; 25=EVTG_OUT3B input is selected; 26=LPTMR0 input is selected; 27=LPTMR1 input is selected; 28=GPIO2 Pin Event Trig 0 input is selected; 29=GPIO2 Pin Event Trig 1 input is selected; 30=GPIO3 Pin Event Trig 0 input is selected; 31=GPIO3 Pin Event Trig 1 input is selected
0x360 ENC0_TRIG reset 0x3F — ENC0 Trigger Input Connections
  [5:0] INP — ENC0 input connections
    0=PINT PIN_INT0 input is selected; 1=PINT PIN_INT4 input is selected; 2=SCT_OUT4 input is selected; 3=SCT_OUT5 input is selected; 4=SCT_OUT1 input is selected; 5=CTIMER0_MAT3 input is selected; 6=CTIMER1_MAT3 input is selected; 7=CTIMER2_MAT3 input is selected; 8=CTIMER1_MAT0 input is selected; 9=CTIMER3_MAT0 input is selected; 11=ARM_TXEV input is selected; 12=PINT GPIO_INT_BMAT input is selected; {v}=ADC0_tcomp[{v-13}] input is selected (v=13..16); {v}=ADC1_tcomp[{v-17}] input is selected (v=17..20); 21=CMP0_OUT input is selected; 22=CMP1_OUT input is selected; 23=CMP2_OUT input is selected; 24=PWM1_A0_TRIG0 input is selected; 25=PWM1_A0_TRIG1 input is selected; 26=PWM1_A1_TRIG0 input is selected; 27=PWM1_A1_TRIG1 input is selected; 28=PWM1_A2_TRIG0 input is selected; 29=PWM1_A2_TRIG1 input is selected; 30=PWM1_A3_TRIG0 input is selected; 31=PWM1_A3_TRIG1 input is selected; 32=ENC0_CMP/POS_MATCH input is selected; 33=ENC1_CMP/POS_MATCH input is selected; 34=EVTG_OUT0A input is selected; 35=EVTG_OUT0B input is selected; 36=EVTG_OUT1A input is selected; 37=EVTG_OUT1B input is selected; 38=EVTG_OUT2A input is selected; 39=EVTG_OUT2B input is selected; 40=EVTG_OUT3A input is selected; 41=EVTG_OUT3B input is selected; {v}=TRIG_IN{v-42} input is selected (v=42..51)
0x364 ENC0_HOME reset 0x3F — ENC0 Input Connections
  [5:0] INP — ENC0 input connections
    0=PINT PIN_INT0 input is selected; 1=PINT PIN_INT4 input is selected; 2=SCT0 SCT_OUT4 input is selected; 3=SCT0 SCT_OUT5 input is selected; 4=SCT0 SCT_OUT1 input is selected; 5=CTIMER0_MAT3 input is selected; 6=CTIMER1_MAT3 input is selected; 7=CTIMER2_MAT3 input is selected; 8=CTIMER1_MAT0 input is selected; 9=CTIMER3_MAT0 input is selected; 11=ARM_TXEV input is selected; 12=PINT GPIO_INT_BMAT input is selected; {v}=ADC0_tcomp[{v-13}] input is selected (v=13..16); {v}=ADC1_tcomp[{v-17}] input is selected (v=17..20); 21=CMP0_OUT input is selected; 22=CMP1_OUT input is selected; 23=CMP2_OUT input is selected; 24=PWM1_A0_TRIG0 input is selected; 25=PWM1_A0_TRIG1 input is selected; 26=PWM1_A1_TRIG0 input is selected; 27=PWM1_A1_TRIG1 input is selected; 28=PWM1_A2_TRIG0 input is selected; 29=PWM1_A2_TRIG1 input is selected; 30=PWM1_A3_TRIG0 input is selected; 31=PWM1_A3_TRIG1 input is selected; 32=ENC0_CMP/POS_MATCH input is selected; 33=ENC1_CMP/POS_MATCH input is selected; 34=EVTG_OUT0A input is selected; 35=EVTG_OUT0B input is selected; 36=EVTG_OUT1A input is selected; 37=EVTG_OUT1B input is selected; 38=EVTG_OUT2A input is selected; 39=EVTG_OUT2B input is selected; 40=EVTG_OUT3A input is selected; 41=EVTG_OUT3B input is selected; {v}=TRIG_IN{v-42} input is selected (v=42..51)
0x368 ENC0_INDEX reset 0x3F — ENC0 Input Connections
  fields as ENC0_TRIG
0x36C ENC0_PHASEB reset 0x3F — ENC0 Input Connections
  fields as ENC0_TRIG
0x370 ENC0_PHASEA reset 0x3F — ENC0 Input Connections
  fields as ENC0_TRIG
0x380 ENC1_TRIG reset 0x3F — ENC1 Trigger Input Connections
  [5:0] INP — ENC1 input connections
    0=PINT PIN_INT0 input is selected; 1=PINT PIN_INT5 input is selected; 2=SCT_OUT4 input is selected; 3=SCT_OUT5 input is selected; 4=SCT_OUT1 input is selected; 5=CTIMER0_MAT3 input is selected; 6=CTIMER1_MAT3 input is selected; 7=CTIMER2_MAT3 input is selected; 8=CTIMER1_MAT1 input is selected; 9=CTIMER3_MAT1 input is selected; 11=ARM_TXEV input is selected; 12=PINT GPIO_INT_BMAT input is selected; {v}=ADC0_tcomp[{v-13}] input is selected (v=13..16); {v}=ADC1_tcomp[{v-17}] input is selected (v=17..20); 21=CMP0_OUT input is selected; 22=CMP1_OUT input is selected; 23=CMP2_OUT input is selected; 24=PWM1_A0_TRIG0 input is selected; 25=PWM1_A0_TRIG1 input is selected; 26=PWM1_A1_TRIG0 input is selected; 27=PWM1_A1_TRIG1 input is selected; 28=PWM1_A2_TRIG0 input is selected; 29=PWM1_A2_TRIG1 input is selected; 30=PWM1_A3_TRIG0 input is selected; 31=PWM1_A3_TRIG1 input is selected; 32=ENC0_CMP/POS_MATCH input is selected; 33=ENC1_CMP/POS_MATCH input is selected; 34=EVTG_OUT0A input is selected; 35=EVTG_OUT0B input is selected; 36=EVTG_OUT1A input is selected; 37=EVTG_OUT1B input is selected; 38=EVTG_OUT2A input is selected; 39=EVTG_OUT2B input is selected; 40=EVTG_OUT3A input is selected; 41=EVTG_OUT3B input is selected; {v}=TRIG_IN{v-42} input is selected (v=42..51)
0x384 ENC1_HOME reset 0x3F — ENC1 Input Connections
  fields as ENC1_TRIG
0x388 ENC1_INDEX reset 0x3F — ENC1 Input Connections
  fields as ENC1_TRIG
0x38C ENC1_PHASEB reset 0x3F — ENC1 Input Connections
  fields as ENC1_TRIG
0x390 ENC1_PHASEA reset 0x3F — ENC1 Input Connections
  fields as ENC1_TRIG
{0x3A0+4i} FlexPWM0_SM_EXTSYNC[{i}] (i=0..3) reset 0x3F — PWM0 External Synchronization
  [5:0] TRIGIN — Trigger input connections for PWM0
    0=PINT PIN_INT0 input is selected; 1=PINT PIN_INT5 input is selected; 2=SCT_OUT4 input is selected; 3=SCT_OUT5 input is selected; 4=SCT_OUT2 input is selected; 5=CTIMER0_MAT3 input is selected; 6=CTIMER1_MAT3 input is selected; 7=CTIMER2_MAT3 input is selected; 8=CTIMER2_MAT0 input is selected; 9=CTIMER4_MAT0 input is selected; 11=ARM_TXEV input is selected; 12=PINT GPIO_INT_BMAT input is selected; {v}=ADC0_tcomp[{v-13}] input is selected (v=13..16); {v}=ADC1_tcomp[{v-17}] input is selected (v=17..20); 21=CMP0_OUT input is selected; 22=CMP1_OUT input is selected; 23=CMP2_OUT input is selected; 24=PWM1_A0_TRIG0 input is selected; 25=PWM1_A0_TRIG1 input is selected; 26=PWM1_A1_TRIG0 input is selected; 27=PWM1_A1_TRIG1 input is selected; 28=PWM1_A2_TRIG0 input is selected; 29=PWM1_A2_TRIG1 input is selected; 30=PWM1_A3_TRIG0 input is selected; 31=PWM1_A3_TRIG1 input is selected; 32=ENC0_CMP/POS_MATCH input is selected; 33=ENC1_CMP/POS_MATCH input is selected; 34=EVTG_OUT0A input is selected; 35=EVTG_OUT0B input is selected; 36=EVTG_OUT1A input is selected; 37=EVTG_OUT1B input is selected; 38=EVTG_OUT2A input is selected; 39=EVTG_OUT2B input is selected; 40=EVTG_OUT3A input is selected; 41=EVTG_OUT3B input is selected; {v}=TRIG_IN{v-42} input is selected (v=42..51); {v}=SINC Filter CH{v-52} sync Break input is selected (v=52..56); 57=GPIO2 Pin Event Trig 0 input is selected; 58=GPIO2 Pin Event Trig 1 input is selected; 59=GPIO3 Pin Event Trig 0 input is selected; 60=GPIO3 Pin Event Trig 1 input is selected
{0x3B0+4i} FlexPWM0_SM_EXTA[{i}] (i=0..3) reset 0x3F — PWM0 Input Trigger Connections
  fields as FlexPWM0_SM_EXTSYNC[0]
0x3C0 FlexPWM0_EXTFORCE reset 0x3F — PWM0 External Force Trigger Connections
  fields as FlexPWM0_SM_EXTSYNC[0]
{0x3C4+4i} FlexPWM0_FAULT[{i}] (i=0..3) reset 0x3F — PWM0 Fault Input Trigger Connections
  fields as FlexPWM0_SM_EXTSYNC[0]
{0x3E0+4i} FlexPWM1_SM_EXTSYNC[{i}] (i=0..3) reset 0x3F — PWM1 External Synchronization
  [5:0] TRIGIN — Trigger input connections for PWM0
    0=PINT PIN_INT0 input is selected; 1=PINT PIN_INT2 input is selected; 2=SCT_OUT4 input is selected; 3=SCT_OUT5 input is selected; 4=SCT_OUT3 input is selected; 5=CTIMER0_MAT3 input is selected; 6=CTIMER1_MAT3 input is selected; 7=CTIMER2_MAT3 input is selected; 8=CTIMER2_MAT1 input is selected; 9=CTIMER4_MAT1 input is selected; 11=ARM_TXEV input is selected; 12=PINT GPIO_INT_BMAT input is selected; {v}=ADC0_tcomp[{v-13}] input is selected (v=13..16); {v}=ADC1_tcomp[{v-17}] input is selected (v=17..20); 21=CMP0_OUT input is selected; 22=CMP1_OUT input is selected; 23=CMP2_OUT input is selected; 24=PWM0_A0_TRIG0 input is selected; 25=PWM0_A0_TRIG1 input is selected; 26=PWM0_A1_TRIG0 input is selected; 27=PWM0_A1_TRIG1 input is selected; 28=PWM0_A2_TRIG0 input is selected; 29=PWM0_A2_TRIG1 input is selected; 30=PWM0_A3_TRIG0 input is selected; 31=PWM0_A3_TRIG1 input is selected; 32=ENC0_CMP/POS_MATCH input is selected; 33=ENC1_CMP/POS_MATCH input is selected; 34=EVTG_OUT0A input is selected; 35=EVTG_OUT0B input is selected; 36=EVTG_OUT1A input is selected; 37=EVTG_OUT1B input is selected; 38=EVTG_OUT2A input is selected; 39=EVTG_OUT2B input is selected; 40=EVTG_OUT3A input is selected; 41=EVTG_OUT3B input is selected; {v}=TRIG_IN{v-42} input is selected (v=42..51); {v}=SINC Filter CH{v-52} sync Break input is selected (v=52..56); 57=GPIO2 Pin Event Trig 0 input is selected; 58=GPIO2 Pin Event Trig 1 input is selected; 59=GPIO3 Pin Event Trig 0 input is selected; 60=GPIO3 Pin Event Trig 1 input is selected
{0x3F0+4i} FlexPWM1_SM_EXTA[{i}] (i=0..3) reset 0x3F — PWM1 Input Trigger Connections
  fields as FlexPWM1_SM_EXTSYNC[0]
0x400 FlexPWM1_EXTFORCE reset 0x3F — PWM1 External Force Trigger Connections
  [5:0] TRIGIN — Trigger input connections for PWM1
    values as FlexPWM1_SM_EXTSYNC[0].TRIGIN
{0x404+4i} FlexPWM1_FAULT[{i}] (i=0..3) reset 0x3F — PWM1 Fault Input Trigger Connections
  fields as FlexPWM1_EXTFORCE
0x420 PWM0_EXT_CLK reset 0x7 — PWM0 External Clock Trigger
  [2:0] TRIGIN — Trigger input connections for PWM
    0=FRO16K input is selected; 1=OSC_32k input is selected; 2=EVTG_OUT0A input is selected; 3=EVTG_OUT1A input is selected; 4=TRIG_IN0 input is selected; 5=TRIG_IN7 input is selected
0x424 PWM1_EXT_CLK reset 0x7 — PWM1 External Clock Trigger
  [3:0] TRIGIN — Trigger input connections for PWM
    values as PWM0_EXT_CLK.TRIGIN
{0x440+4i} EVTG_TRIG{i} reset 0x3F (i=0..3) — EVTG Trigger Input Connections {i}
  [5:0] INP — EVTG trigger input connections
    0=PINT PIN_INT0 input is selected; 1=PINT PIN_INT1 input is selected; {v}=SCT_OUT{v-2} input is selected (v=2..5); 6=CTIMER0_MAT3 input is selected; 7=CTIMER1_MAT3 input is selected; 8=CTIMER2_MAT3 input is selected; 9=CTIMER2_MAT2 input is selected; 10=CTIMER3_MAT2 input is selected; 11=CTIMER4_MAT2 input is selected; 13=PINT GPIO_INT_BMAT input is selected; 14=ADC0_IRQ input is selected; 15=ADC1_IRQ input is selected; {v}=ADC0_tcomp[{v-16}] input is selected (v=16..19); {v}=ADC1_tcomp[{v-20}] input is selected (v=20..23); 24=CMP0_OUT input is selected; 25=CMP1_OUT input is selected; 26=CMP2_OUT input is selected; 27=PWM0_A0_TRIG0 input is selected; 28=PWM0_A0_TRIG1 input is selected; 29=PWM0_A1_TRIG0 input is selected; 30=PWM0_A1_TRIG1 input is selected; 31=PWM0_A2_TRIG0 input is selected; 32=PWM0_A2_TRIG1 input is selected; 33=PWM0_A3_TRIG0 input is selected; 34=PWM0_A3_TRIG1 input is selected; 35=PWM1_A0_TRIG0 input is selected; 36=PWM1_A0_TRIG1 input is selected; 37=PWM1_A1_TRIG0 input is selected; 38=PWM1_A1_TRIG1 input is selected; 39=PWM1_A2_TRIG0 input is selected; 40=PWM1_A2_TRIG1 input is selected; 41=PWM1_A3_TRIG0 input is selected; 42=PWM1_A3_TRIG1 input is selected; 43=ENC0_CMP/POS_MATCH input is selected; 44=ENC1_CMP/POS_MATCH input is selected; {v}=TRIG_IN{v-45} input is selected (v=45..48); 49=LPTMR0 input is selected; 50=LPTMR1 input is selected; {v}=SINC Filter CH{v-51} Break input is selected (v=51..55)
0x450 EVTG_TRIG4 reset 0x3F — EVTG Trigger Input Connections 4
  [5:0] INP — EVTG trigger input connections
    0=PINT PIN_INT0 input is selected; 1=PINT PIN_INT1 input is selected; {v}=SCT_OUT{v-2} input is selected (v=2..5); 6=CTIMER0_MAT3 input is selected; 7=CTIMER1_MAT3 input is selected; 8=CTIMER2_MAT3 input is selected; 9=CTIMER2_MAT2 input is selected; 10=CTIMER3_MAT2 input is selected; 11=CTIMER4_MAT2 input is selected; 13=GPIO_INT_BMATCH input is selected; 14=ADC0_IRQ input is selected; 15=ADC1_IRQ input is selected; {v}=ADC0_tcomp[{v-16}] input is selected (v=16..19); {v}=ADC1_tcomp[{v-20}] input is selected (v=20..23); 24=CMP0_OUT input is selected; 25=CMP1_OUT input is selected; 26=CMP2_OUT input is selected; 27=PWM0_A0_TRIG0 input is selected; 28=PWM0_A0_TRIG1 input is selected; 29=PWM0_A1_TRIG0 input is selected; 30=PWM0_A1_TRIG1 input is selected; 31=PWM0_A2_TRIG0 input is selected; 32=PWM0_A2_TRIG1 input is selected; 33=PWM0_A3_TRIG0 input is selected; 34=PWM0_A3_TRIG1 input is selected; 35=PWM1_A0_TRIG0 input is selected; 36=PWM1_A0_TRIG1 input is selected; 37=PWM1_A1_TRIG0 input is selected; 38=PWM1_A1_TRIG1 input is selected; 39=PWM1_A2_TRIG0 input is selected; 40=PWM1_A2_TRIG1 input is selected; 41=PWM1_A3_TRIG0 input is selected; 42=PWM1_A3_TRIG1 input is selected; 43=ENC0_CMP/POS_MATCH input is selected; 44=ENC1_CMP/POS_MATCH input is selected; {v}=TRIG_IN{v-45} input is selected (v=45..48); 49=LPTMR0 input is selected; 50=LPTMR1 input is selected; {v}=SINC Filter CH{v-51} Break input is selected (v=51..55)
{0x440+4i} EVTG_TRIG{i} reset 0x3F (i=5..15) — EVTG Trigger Input Connections {i}
  fields as EVTG_TRIG0
0x480 USBFS_TRIG reset 0xF — USB-FS Trigger Input Connections
  [3:0] INP — USB-FS trigger input connections. The trigger output of LP_FLEXCOMM is an input of peripheral INPUTMUX.
    {v}=LP_FLEXCOMM {v} trigger out [3] input is selected (v=0..9)
0x4A0 TSI_TRIG reset 0x3 — TSI Trigger Input Connections
  [1:0] INP — TSI trigger input connections
    0=LPTMR0 input is selected; 1=LPTMR1 input is selected
{0x4C0+4i} EXT_TRIG{i} reset 0x3F (i=0..7) — EXT Trigger Connections {i}
  [5:0] INP — EXT trigger input connections
    0=PINT PIN_INT0 input is selected; 1=PINT PIN_INT1 input is selected; 2=ADC0_IRQ input is selected; 3=ADC1_IRQ input is selected; 4=ADC0_tcomp[0] input is selected; 5=ADC1_tcomp[0] input is selected; {v}=PWM0_A{v-6}_TRIG0/PWM0_A{v-6}_TRIG1 input is selected (v=6..9); {v}=PWM1_A{v-10}_TRIG0/PWM1_A{v-10}_TRIG1 input is selected (v=10..13); 14=ENC0_CMP/POS_MATCH input is selected; 15=ENC1_CMP/POS_MATCH input is selected; 16=EVTG_OUT0A input is selected; 17=EVTG_OUT0B input is selected; 18=EVTG_OUT1A input is selected; 19=EVTG_OUT1B input is selected; 20=EVTG_OUT2A input is selected; 21=EVTG_OUT2B input is selected; 22=EVTG_OUT3A input is selected; 23=EVTG_OUT3B input is selected; 26=LPTMR0 input is selected; 27=LPTMR1 input is selected; {v}=SCT Out{v-28} input is selected (v=28..33); {v}=Flexcomm{v-34} trigger output 3 input is selected (v=34..43); 44=CMP0_OUT input is selected; 45=CMP1_OUT input is selected; 46=CMP2_OUT input is selected; 47=ENET_PPS_OUT_0 input is selected
0x4E0 CMP1_TRIG reset 0x3F — CMP1 Input Connections
  [5:0] TRIGIN — CMP1 input trigger
    0=PINT PIN_INT0 input is selected; 1=PINT PIN_INT7 input is selected; 2=SCT0 SCT_OUT4 input is selected; 3=SCT0 SCT_OUT5 input is selected; 4=SCT0 SCT_OUT7 input is selected; 5=CTIMER0_MAT3 input is selected; 6=CTIMER1_MAT3 input is selected; 7=CTIMER2_MAT3 input is selected; 8=CTIMER3_MAT1 input is selected; 9=CTIMER4_MAT1 input is selected; 11=ARM_TXEV input is selected; 12=PINT GPIO_INT_BMAT input is selected; 13=ADC0_tcomp[1] input is selected; 14=ADC1_tcomp[1] input is selected; {v}=PWM0_A{v-17}_TRIG0/PWM0_A{v-17}_TRIG1 input is selected (v=17..20); {v}=PWM1_A{v-21}_TRIG0/PWM1_A{v-21}_TRIG1 input is selected (v=21..24); 25=ENC0_CMP/POS_MATCH input is selected; 26=ENC1_CMP/POS_MATCH input is selected; 27=EVTG_OUT0A input is selected; 28=EVTG_OUT0B input is selected; 29=EVTG_OUT1A input is selected; 30=EVTG_OUT1B input is selected; 31=EVTG_OUT2A input is selected; 32=EVTG_OUT2B input is selected; 33=EVTG_OUT3A input is selected; 34=EVTG_OUT3B input is selected; 35=LPTMR0 input is selected; 36=LPTMR1 input is selected; 37=GPIO2 Pin Event Trig 0 input is selected; 38=GPIO2 Pin Event Trig 1 input is selected; 39=GPIO3 Pin Event Trig 0 input is selected; 40=GPIO3 Pin Event Trig 1 input is selected
0x500 CMP2_TRIG reset 0x3F — CMP2 Input Connections
  [5:0] TRIGIN — CMP2 input trigger
    0=PINT PIN_INT0 input is selected; 1=PINT PIN_INT4 input is selected; 2=SCT0 SCT_OUT4 input is selected; 3=SCT0 SCT_OUT5 input is selected; 4=SCT0 SCT_OUT8 input is selected; 5=CTIMER0_MAT3 input is selected; 6=CTIMER1_MAT3 input is selected; 7=CTIMER2_MAT3 input is selected; 8=CTIMER3_MAT2 input is selected; 9=CTIMER4_MAT2 input is selected; 11=ARM_TXEV input is selected; 12=PINT GPIO_INT_BMAT input is selected; 13=ADC0_tcomp[2] input is selected; 14=ADC1_tcomp[2] input is selected; {v}=PWM0_A{v-17}_TRIG0/PWM0_A{v-17}_TRIG1 input is selected (v=17..20); {v}=PWM1_A{v-21}_TRIG0/PWM1_A{v-21}_TRIG1 input is selected (v=21..24); 25=ENC0_CMP/POS_MATCH input is selected; 26=ENC1_CMP/POS_MATCH input is selected; 27=EVTG_OUT0A input is selected; 28=EVTG_OUT0B input is selected; 29=EVTG_OUT1A input is selected; 30=EVTG_OUT1B input is selected; 31=EVTG_OUT2A input is selected; 32=EVTG_OUT2B input is selected; 33=EVTG_OUT3A input is selected; 34=EVTG_OUT3B input is selected; 35=LPTMR0 input is selected; 36=LPTMR1 input is selected; 37=GPIO2 Pin Event Trig 0 input is selected; 38=GPIO2 Pin Event Trig 1 input is selected; 39=GPIO3 Pin Event Trig 0 input is selected; 40=GPIO3 Pin Event Trig 1 input is selected
{0x520+4i} SINC_FILTER_CH{i} reset 0x3F (i=0..4) — SINC Filter Channel{i} Trigger Input Connections
  [5:0] INP — SINC FILTER trigger input connections
    0=PINT PIN_INT0 input is selected; 1=PINT PIN_INT1 input is selected; 2=SCT_OUT4 input is selected; 3=SCT_OUT5 input is selected; 4=SCT_OUT9 input is selected; {v}=CTIMER{v-5}_MAT3 input is selected (v=5..9); 11=ARM_TXEV input is selected; 12=PINT GPIO_INT_BMAT input is selected; {v}=ADC0_tcomp[{v-13}] input is selected (v=13..16); {v}=ADC1_tcomp[{v-17}] input is selected (v=17..20); 21=CMP0_OUT input is selected; 22=CMP1_OUT input is selected; 23=CMP2_OUT input is selected; 24=PWM0_A0_TRIG0 input is selected; 25=PWM0_A0_TRIG1 input is selected; 26=PWM0_A1_TRIG0 input is selected; 27=PWM0_A1_TRIG1 input is selected; 28=PWM0_A2_TRIG0 input is selected; 29=PWM0_A2_TRIG1 input is selected; 30=PWM0_A3_TRIG0 input is selected; 31=PWM0_A3_TRIG1 input is selected; 32=PWM1_A0_TRIG0 input is selected; 33=PWM1_A0_TRIG1 input is selected; 34=PWM1_A1_TRIG0 input is selected; 35=PWM1_A1_TRIG1 input is selected; 36=PWM1_A2_TRIG0 input is selected; 37=PWM1_A2_TRIG1 input is selected; 38=PWM1_A3_TRIG0 input is selected; 39=PWM1_A3_TRIG1 input is selected; 40=ENC0_CMP/POS_MATCH input is selected; 41=ENC1_CMP/POS_MATCH input is selected; 42=EVTG_OUT0A input is selected; 43=EVTG_OUT0B input is selected; 44=EVTG_OUT1A input is selected; 45=EVTG_OUT1B input is selected; 46=EVTG_OUT2A input is selected; 47=EVTG_OUT2B input is selected; 48=EVTG_OUT3A input is selected; 49=EVTG_OUT3B input is selected; 50=LPTMR0 input is selected; 51=LPTMR1 input is selected; {v}=FlexIO CH{v-52} input is selected (v=52..55); 56=WUU input is selected
