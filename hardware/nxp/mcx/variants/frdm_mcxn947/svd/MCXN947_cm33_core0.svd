# MCXN947_cm33_core0 register map
Vendor: nxp.com; File version: 1.0
MCXN947VDF,MCXN947VNL
CPU: CM33 r2p0, little endian, MPU, FPU, VTOR, 3 interrupt priority bits
Registers are 32-bit, read-write, reset 0x0 unless marked. A register's access mark holds for its fields unless they carry their own. Offsets are from the block's base; lines under a group give offsets from that group; [hi:lo] are bit positions; {n}, {i} and the like mark numbered series; 'fields as' and 'values as' point back to an identical list; <NAME> marks a mode.

## Memory map
0x40000000 SYSCON0 size 0x1000 — SYSCON
0x40004000 PINT0 size 0x34 — Pin Interrupts and Pattern Match
0x40006000 INPUTMUX0 size 0x7BC — INPUTMUX
0x4000C000 CTIMER0 size 0x88 — CTIMER
0x4000D000 CTIMER1 size 0x88 — CTIMER
0x4000E000 CTIMER2 size 0x88 — CTIMER
0x4000F000 CTIMER3 size 0x88 — CTIMER
0x40010000 CTIMER4 size 0x88 — CTIMER
0x40011000 FREQME0 size 0x10 — FREQME
0x40012000 UTICK0 size 0x20 — UTICK
0x40013000 MRT0 size 0xFC — Multi-Rate Timer (MRT)
0x40016000 WWDT0 size 0x1C — WWDT
0x40017000 WWDT1 size 0x1C — WWDT
0x4001B000 CACHE64_CTRL0 size 0x810 — CACHE64_CTRL
0x4001B000 CACHE64_POLSEL0 size 0x20 — CACHE64_POLSEL
0x40021000 I3C0 size 0x1000 — I3C
0x40022000 I3C1 size 0x1000 — I3C
0x40024000 GDET0 size 0x1000
0x40025000 GDET1 size 0x1000
0x40026000 ITRC0 size 0xF8 — Intrusion and Tamper Response Controller
0x4002B000 PKC0 size 0x1000
0x4002C000 PUF size 0x3F0
0x4002C000 PUF_CTRL size 0x10C — PUF Key Context Management
0x4002D000 PUF_ALIAS1 size 0x3F0 — PUF
0x4002D000 PUF_CTRL_ALIAS1 size 0x10C — PUF Key Context Management
0x4002E000 PUF_ALIAS2 size 0x3F0 — PUF
0x4002E000 PUF_CTRL_ALIAS2 size 0x10C — PUF Key Context Management
0x4002F000 PUF_ALIAS3 size 0x3F0 — PUF
0x4002F000 PUF_CTRL_ALIAS3 size 0x10C — PUF Key Context Management
0x40031000 SM3_0 size 0xFF0 — SAFO_SM3_SGI
0x40032000 BSP32_0 size 0x38 — CoolFlux BSP32
0x40033000 SMARTDMA0 size 0x4C — SmartDMA
0x40034000 PLU0 size 0xC20 — Programmable Logic Unit (PLU)
0x40040000 GPIO5 size 0x128 — GPIO
0x40041000 GPIO5_ALIAS1 size 0x128 — GPIO
0x40042000 PORT5 size 0xA8 — PORT
0x40043000 FMU0 size 0x30 — Flash
0x40044000 SCG0 size 0x904 — SCG
0x40045000 SPC0 size 0x600 — SPC
0x40046000 WUU0 size 0x5C — WUU
0x40048000 CMC0 size 0x124 — CMC
0x40049000 OSTIMER0 size 0x20 — OSTIMER
0x4004A000 LPTMR0 size 0x10 — LPTMR
0x4004B000 LPTMR1 size 0x10 — LPTMR
0x4004C000 RTC0 size 0x2A — RTC
0x4004C000 RTC_SUBSYSTEM0 size 0xC10 — RTC_SUBSYSTEM
0x4004E000 FMU0TEST size 0x1000 — FlashTest
0x40050000 TSI0 size 0x110 — TSI
0x40051000 CMP0 size 0x3C — LPCMP
0x40052000 CMP1 size 0x3C — LPCMP
0x40053000 CMP2 size 0x3C — LPCMP
0x40054000 ELS size 0x1000
0x40055000 ELS_ALIAS1 size 0x1000
0x40056000 ELS_ALIAS2 size 0x1000
0x40057000 ELS_ALIAS3 size 0x1000
0x40058000 TDET0 size 0x60 — TDET
0x40059000 VBAT0 size 0x800 — VBAT
0x4005A000 TRNG0 size 0xFF
0x4005B000 EIM0 size 0x308 — EIM
0x4005C000 ERM0 size 0x19C — ERM
0x4005D000 INTM0 size 0x48 — INTM
0x40080000 DMA0 size 0x140 — DMA MP
0x40081000 EDMA_0_TCD size 0xF040 — DMA TCD
0x40091000 SCT0 size 0x550 — SCT
0x40092000 LPSPI0 size 0x800 — LPSPI
0x40092000 LPUART0 size 0x800 — LPUART
0x40092000 LP_FLEXCOMM0 size 0xFFC — LP_FLEXCOMM
0x40092800 LPI2C0 size 0x7F4 — LPI2C
0x40093000 LPSPI1 size 0x800 — LPSPI
0x40093000 LPUART1 size 0x800 — LPUART
0x40093000 LP_FLEXCOMM1 size 0xFFC — LP_FLEXCOMM
0x40093800 LPI2C1 size 0x7F4 — LPI2C
0x40094000 LPSPI2 size 0x800 — LPSPI
0x40094000 LPUART2 size 0x800 — LPUART
0x40094000 LP_FLEXCOMM2 size 0xFFC — LP_FLEXCOMM
0x40094800 LPI2C2 size 0x7F4 — LPI2C
0x40095000 LPSPI3 size 0x800 — LPSPI
0x40095000 LPUART3 size 0x800 — LPUART
0x40095000 LP_FLEXCOMM3 size 0xFFC — LP_FLEXCOMM
0x40095800 LPI2C3 size 0x7F4 — LPI2C
0x40096000 GPIO0 size 0x128 — GPIO
0x40097000 GPIO0_ALIAS1 size 0x128 — GPIO
0x40098000 GPIO1 size 0x128 — GPIO
0x40099000 GPIO1_ALIAS1 size 0x128 — GPIO
0x4009A000 GPIO2 size 0x128 — GPIO
0x4009B000 GPIO2_ALIAS1 size 0x128 — GPIO
0x4009C000 GPIO3 size 0x128 — GPIO
0x4009D000 GPIO3_ALIAS1 size 0x128 — GPIO
0x4009E000 GPIO4 size 0x128 — GPIO
0x4009F000 GPIO4_ALIAS1 size 0x128 — GPIO
0x400A0000 DMA1 size 0x140 — DMA MP
0x400A1000 EDMA_1_TCD size 0xF040 — DMA TCD
0x400B1000 SEMA42_0 size 0x44 — SEMA42
0x400B2000 MAILBOX size 0xFC
0x400B4000 LPSPI4 size 0x800 — LPSPI
0x400B4000 LPUART4 size 0x800 — LPUART
0x400B4000 LP_FLEXCOMM4 size 0xFFC — LP_FLEXCOMM
0x400B4800 LPI2C4 size 0x7F4 — LPI2C
0x400B5000 LPSPI5 size 0x800 — LPSPI
0x400B5000 LPUART5 size 0x800 — LPUART
0x400B5000 LP_FLEXCOMM5 size 0xFFC — LP_FLEXCOMM
0x400B5800 LPI2C5 size 0x7F4 — LPI2C
0x400B6000 LPSPI6 size 0x800 — LPSPI
0x400B6000 LPUART6 size 0x800 — LPUART
0x400B6000 LP_FLEXCOMM6 size 0xFFC — LP_FLEXCOMM
0x400B6800 LPI2C6 size 0x7F4 — LPI2C
0x400B7000 LPSPI7 size 0x800 — LPSPI
0x400B7000 LPUART7 size 0x800 — LPUART
0x400B7000 LP_FLEXCOMM7 size 0xFFC — LP_FLEXCOMM
0x400B7800 LPI2C7 size 0x7F4 — LPI2C
0x400B8000 LPSPI8 size 0x800 — LPSPI
0x400B8000 LPUART8 size 0x800 — LPUART
0x400B8000 LP_FLEXCOMM8 size 0xFFC — LP_FLEXCOMM
0x400B8800 LPI2C8 size 0x7F4 — LPI2C
0x400B9000 LPSPI9 size 0x800 — LPSPI
0x400B9000 LPUART9 size 0x800 — LPUART
0x400B9000 LP_FLEXCOMM9 size 0xFFC — LP_FLEXCOMM
0x400B9800 LPI2C9 size 0x7F4 — LPI2C
0x400BB000 CDOG0 size 0x50 — CDOG
0x400BC000 CDOG1 size 0x50 — CDOG
0x400BD000 DM0 size 0x100 — DBGMB
0x400BF000 POWERQUAD size 0x260
0x400C0000 EWM0 size 0x6 — EWM
0x400C1000 CMX_PERFMON0 size 0x30 — CMX_PERFMON
0x400C2000 CMX_PERFMON1 size 0x30 — CMX_PERFMON
0x400C6000 TRDC size 0x11CC
0x400C8000 FLEXSPI0 size 0x5F8 — FlexSPI
0x400C9000 OTPC0 size 0x220 — OTPC
0x400CB000 CRC0 size 0xC — CRC
0x400CC000 NPX0 size 0x80 — FMC
0x400CE000 PWM0 size 0x196 — PWM
0x400CF000 ENC0 size 0x34 — ENC
0x400D0000 PWM1 size 0x196 — PWM
0x400D1000 ENC1 size 0x34 — ENC
0x400D2000 EVTG0 size 0x40 — EVTG
0x400D4000 CAN0 size 0x3080 — CAN
0x400D8000 CAN1 size 0x3080 — CAN
0x400DC000 USBDCD0 size 0x1C — USBDCD
0x400DD000 USBFS0 size 0x15D — USBFS
0x40100000 ENET0 size 0x11F0 — ENET
0x40103000 EMVSIM0 size 0x4C — EMVSIM
0x40104000 EMVSIM1 size 0x4C — EMVSIM
0x40105000 FLEXIO0 size 0x920 — FLEXIO
0x40106000 SAI0 size 0x104 — SAI
0x40107000 SAI1 size 0x104 — SAI
0x40108000 SINC0 size 0x200 — SINC
0x40109000 USDHC0 size 0xD0 — uSDHC
0x4010A000 USBPHY size 0x160
0x4010A800 USBHS1_PHY_DCD size 0x1C — USBDCD
0x4010B000 USBHS1__USBC size 0x1E0 — USB
0x4010B200 USBHS1__USBNC size 0x14 — USBNC
0x4010C000 PDM size 0x8C — MICFIL
0x4010D000 ADC0 size 0x584 — ADC
0x4010E000 ADC1 size 0x584 — ADC
0x4010F000 DAC0 size 0x30 — 12-bit DAC
0x40110000 OPAMP0 size 0xC — OPAMP
0x40111000 VREF0 size 0x14 — VREF
0x40112000 DAC1 size 0x30 — 12-bit DAC
0x40113000 OPAMP1 size 0xC — OPAMP
0x40114000 DAC2 size 0x30 — 14-bit DAC
0x40115000 OPAMP2 size 0xC — OPAMP
0x40116000 PORT0 size 0x100 — PORT
0x40117000 PORT1 size 0x100 — PORT
0x40118000 PORT2 size 0xB0 — PORT
0x40119000 PORT3 size 0xE0 — PORT
0x4011A000 PORT4 size 0xE0 — PORT
0x40120000 AHBSC size 0x1000
0x40121000 AHBSC_ALIAS1 size 0x1000 — AHBSC
0x40122000 AHBSC_ALIAS2 size 0x1000 — AHBSC
0x40123000 AHBSC_ALIAS3 size 0x1000 — AHBSC
0xE000E000 SCnSCB size 0x10
0xE000E010 SysTick0 size 0x10 — M33 Systick module
0xE000E100 NVIC size 0xE04
0xE000ED00 SCB size 0x90
0xE000ED90 MPU size 0x40 — Memory Protection Unit
0xE000EDD0 SAU size 0xEC

## Interrupts
{n+1} EDMA_0_CH{n} (DMA0) (n=0..15)
17 GPIO00 (GPIO0, GPIO0_ALIAS1)
18 GPIO01 (GPIO0, GPIO0_ALIAS1)
19 GPIO10 (GPIO1, GPIO1_ALIAS1)
20 GPIO11 (GPIO1, GPIO1_ALIAS1)
21 GPIO20 (GPIO2, GPIO2_ALIAS1)
22 GPIO21 (GPIO2, GPIO2_ALIAS1)
23 GPIO30 (GPIO3, GPIO3_ALIAS1)
24 GPIO31 (GPIO3, GPIO3_ALIAS1)
25 GPIO40 (GPIO4, GPIO4_ALIAS1)
26 GPIO41 (GPIO4, GPIO4_ALIAS1)
27 GPIO50 (GPIO5, GPIO5_ALIAS1)
28 GPIO51 (GPIO5, GPIO5_ALIAS1)
29 UTICK0
30 MRT0
31 CTIMER0
32 CTIMER1
33 SCT0
34 CTIMER2
{n+35} LP_FLEXCOMM{n} (LPSPI{n}, LPUART{n}, LP_FLEXCOMM{n}, LPI2C{n}) (n=0..9)
45 ADC0
46 ADC1
47 PINT0
48 PDM_EVENT (PDM)
50 USB0_FS (USBFS0)
51 USB0_DCD (USBDCD0)
52 RTC (RTC0)
53 SMARTDMA (SMARTDMA0)
54 MAILBOX
55 CTIMER3
56 CTIMER4
57 OS_EVENT (OSTIMER0)
58 FLEXSPI0
59 SAI0
60 SAI1
61 USDHC0
62 CAN0
63 CAN1
66 USB1_HS_PHY (USBPHY)
67 USB1_HS (USBHS1__USBC)
68 SEC_HYPERVISOR_CALL (AHBSC, AHBSC_ALIAS{n} (n=1..3))
70 PLU (PLU0)
71 Freqme (FREQME0)
72 SEC_VIO (TRDC)
73 ELS
74 PKC (PKC0)
75 PUF
76 PQ (POWERQUAD)
{n+77} EDMA_1_CH{n} (DMA1) (n=0..15)
93 CDOG0
94 CDOG1
95 I3C0
96 I3C1
98 GDET (GDET0, GDET1)
99 VBAT0 (TDET0, VBAT0)
100 EWM0
101 TSI_END_OF_SCAN (TSI0)
102 TSI_OUT_OF_SCAN (TSI0)
103 EMVSIM0
104 EMVSIM1
105 FLEXIO (FLEXIO0)
106 DAC0
107 DAC1
108 DAC2
109 HSCMP0 (CMP0)
110 HSCMP1 (CMP1)
111 HSCMP2 (CMP2)
112 FLEXPWM0_RELOAD_ERROR (PWM0)
113 FLEXPWM0_FAULT (PWM0)
114 FLEXPWM0_SUBMODULE0 (PWM0)
115 FLEXPWM0_SUBMODULE1 (PWM0)
116 FLEXPWM0_SUBMODULE2 (PWM0)
117 FLEXPWM0_SUBMODULE3 (PWM0)
118 FLEXPWM1_RELOAD_ERROR (PWM1)
119 FLEXPWM1_FAULT (PWM1)
120 FLEXPWM1_SUBMODULE0 (PWM1)
121 FLEXPWM1_SUBMODULE1 (PWM1)
122 FLEXPWM1_SUBMODULE2 (PWM1)
123 FLEXPWM1_SUBMODULE3 (PWM1)
124 ENC0_COMPARE (ENC0)
125 ENC0_HOME (ENC0)
126 ENC0_WDG_SAB (ENC0)
127 ENC0_IDX (ENC0)
128 ENC1_COMPARE (ENC1)
129 ENC1_HOME (ENC1)
130 ENC1_WDG_SAB (ENC1)
131 ENC1_IDX (ENC1)
132 ITRC0
133 BSP32 (BSP32_0)
134 ELS_ERR (ELS)
135 PKC_ERR (PKC0)
136 ERM_SINGLE_BIT_ERROR (ERM0)
137 ERM_MULTI_BIT_ERROR (ERM0)
138 FMU0
139 ETHERNET (ENET0)
140 ETHERNET_PMT (ENET0)
141 ETHERNET_MACLP (ENET0)
142 SINC_FILTER (SINC0)
143 LPTMR0
144 LPTMR1
145 SCG (SCG0)
146 SPC (SPC0)
147 WUU (WUU0)
148 PORT_EFT (PORT{n} (n=0..5))
149 ETB0 (SYSCON0)
150 SM3 (SM3_0)
151 TRNG0
152 WWDT0
153 WWDT1
154 CMC0
155 CTI0 (SYSCON0)

## Licence text in the file
Copyright 2016-2023 NXP SPDX-License-Identifier: BSD-3-Clause
