# MCXN236 register map
Vendor: nxp.com; File version: 1.0
CPU: CM33 r2p0, little endian, MPU, FPU, VTOR, 3 interrupt priority bits
Registers are 32-bit, read-write, reset 0x0 unless marked. A register's access mark holds for its fields unless they carry their own. Offsets are from the block's base; [hi:lo] are bit positions; lines under a group give offsets from that group; {n}, {i} and the like mark numbered series; 'fields as' and 'values as' point back to an identical list.

## INPUTMUX0 (part 1 of 2) — INPUTMUX
Base 0x40006000
{0x0+0x20*i} ENCn[{i}] (i=0..1) group
  0x360 ENC_TRIG reset 0x3F — ENCouter_loop Trigger Input Connections
    [5:0] INP — ENC0 trigger input connections
      0=PINT PIN_INT0 input is selected; 1=PINT PIN_INT4 input is selected; 5=CTIMER0_MAT3 input is selected; 6=CTIMER1_MAT3 input is selected; 7=CTIMER2_MAT3 input is selected; 8=CTIMER1_MAT0 input is selected; 9=CTIMER3_MAT0 input is selected; 11=ARM_TXEV input is selected; 12=PINT GPIO_INT_BMAT input is selected; {v}=ADC0_tcomp[{v-13}] input is selected (v=13..16); {v}=ADC1_tcomp[{v-17}] input is selected (v=17..20); 21=CMP0_OUT input is selected; 22=CMP1_OUT input is selected; 24=PWM1_A0_TRIG0 input is selected; 25=PWM1_A0_TRIG1 input is selected; 26=PWM1_A1_TRIG0 input is selected; 27=PWM1_A1_TRIG1 input is selected; 28=PWM1_A2_TRIG0 input is selected; 29=PWM1_A2_TRIG1 input is selected; 30=PWM1_A3_TRIG0 input is selected; 31=PWM1_A3_TRIG1 input is selected; 32=ENC0_CMP/POS_MATCH input is selected; 33=ENC1_CMP/POS_MATCH input is selected; 34=EVTG_OUT0A input is selected; 35=EVTG_OUT0B input is selected; 36=EVTG_OUT1A input is selected; 37=EVTG_OUT1B input is selected; 38=EVTG_OUT2A input is selected; 39=EVTG_OUT2B input is selected; 40=EVTG_OUT3A input is selected; 41=EVTG_OUT3B input is selected; {v}=TRIG_IN{v-42} input is selected (v=42..51)
  0x364 ENC_HOME reset 0x3F — ENCouter_loop Input Connections
    [5:0] INP — ENC0 HOME input connections
      values as ENCn[0].ENC_TRIG.INP
  0x368 ENC_INDEX reset 0x3F — ENCouter_loop Input Connections
    [5:0] INP — ENC0 INDEX input connections
      values as ENCn[0].ENC_TRIG.INP
  0x36C ENC_PHASEB reset 0x3F — ENCouter_loop Input Connections
    [5:0] INP — ENC0 PHASEB input connections
      values as ENCn[0].ENC_TRIG.INP
  0x370 ENC_PHASEA reset 0x3F — ENCouter_loop Input Connections
    [5:0] INP — ENC0 PHASEA input connections
      values as ENCn[0].ENC_TRIG.INP
{0x20+4i} CTIMER0CAP{i} reset 0x7F (i=0..3) — Capture Select Register for CTIMER Inputs
  [6:0] INP — Input number for CTIMER
    {v}=CT_INP{v} input is selected (v=0..19); 20=usb0 start of frame input is selected; 21=usb1 start of frame input is selected; 22=DCDC_BURST_ACTIVE input is selected; 23=sai0_tx_sync_outsai_tx_sync_out is Transmit Frame Sync for multi-SAI synchronous operation. input is selected; 24=sai0_rx_sync_outsai_rx_sync_out is Receive Frame Sync for multi-SAI synchronous operation. input is selected; 25=ADC0_IRQ input is selected; 26=ADC1_IRQ input is selected; 27=CMP0_OUT input is selected; 28=CMP1_OUT input is selected; {v}=PWM0_A{v-30}_TRIG0/PWM0_A{v-30}_TRIG1 input is selected (v=30..33); {v}=PWM1_A{v-34}_TRIG0/PWM1_A{v-34}_TRIG1 input is selected (v=34..37); 38=ENC0_CMP/POS_MATCH input is selected; 39=ENC1_CMP/POS_MATCH input is selected; 40=EVTG_OUT0A input is selected; 41=EVTG_OUT0B input is selected; 42=EVTG_OUT1A input is selected; 43=EVTG_OUT1B input is selected; 44=EVTG_OUT2A input is selected; 45=EVTG_OUT2B input is selected; 46=EVTG_OUT3A input is selected; 47=EVTG_OUT3B input is selected; 50=LP_FLEXCOMM0 trig 0 input is selected; 51=LP_FLEXCOMM0 trig 1 input is selected; 52=LP_FLEXCOMM0 trig 2 input is selected; 53=LP_FLEXCOMM1 trig 0 input is selected; 54=LP_FLEXCOMM1 trig 1 input is selected; 55=LP_FLEXCOMM1 trig 2 input is selected; 56=LP_FLEXCOMM2 trig 0 input is selected; 57=LP_FLEXCOMM2 trig 1 input is selected; 58=LP_FLEXCOMM2 trig 2 input is selected; {v}=LP_FLEXCOMM3 trig {v-59} input is selected (v=59..62); 63=sai1_tx_sync_outsai_tx_sync_out is Transmit Frame Sync for multi-SAI synchronous operation. input is selected; 64=sai1_rx_sync_outsai_rx_sync_out is Receive Frame Sync for multi-SAI synchronous operation. input is selected
{0x30+0x20*i} TIMER{i}TRIG reset 0x7F (i=0..2) — Trigger Register for CTIMER
  fields as CTIMER0CAP0
{0x40+4i} CTIMER1CAP{i} reset 0x7F (i=0..3) — Capture Select Register for CTIMER Inputs
  fields as CTIMER0CAP0
{0x60+4i} CTIMER2CAP{i} reset 0x7F (i=0..3) — Capture Select Register for CTIMER Inputs
  fields as CTIMER0CAP0
{0xA0+4i} SMARTDMAARCHB_INMUX[{i}] (i=0..7) reset 0x7F — Inputmux Register for SMARTDMA Arch B Inputs
  [6:0] INP — Input number select to SmartDMA ARCHB input
    {v}=GPIO P0_{v} input is selected (v=0..7); {v}=GPIO P0_{v} input is selected (v=12..15); 20=MRT0 MRT_CH0_IRQ input is selected; 21=MRT0 MRT_CH1_IRQ input is selected; 22=CTIMER4_MAT3 input is selected; 23=CTIMER4_MAT2 input is selected; 24=CTIMER3_MAT3 input is selected; 25=CTIMER3_MAT2 input is selected; 26=CTIMER1_MAT3 input is selected; 27=CTIMER1_MAT2 input is selected; 28=UTICK0 UTICK_IRQ input is selected; 29=WWDT0 WDT0_IRQ input is selected; 30=ADC0 ADC0_IRQ input is selected; 31=CMP0_IRQ input is selected; 33=LP_FLEXCOMM7_IRQ input is selected; 34=LP_FLEXCOMM6_IRQ input is selected; 35=LP_FLEXCOMM5_IRQ input is selected; 36=LP_FLEXCOMM4_IRQ input is selected; 37=LP_FLEXCOMM3_IRQ input is selected; 38=LP_FLEXCOMM2_IRQ input is selected; 39=LP_FLEXCOMM1_IRQ input is selected; 40=LP_FLEXCOMM0_IRQ input is selected; 41=DMA0_IRQ input is selected; 42=DMA1_IRQ input is selected; 43=SYS_IRQSYS_IRQ combines the CDOG IRQ, WWDT IRQ, MBC secure violation IRQ, Secure AHB Matrix secure violation IRQ, GDET IRQ, ELS S50 error IRQ, PKC error IRQ, and VBAT IRQ using the logical OR operation. input is selected; 44=RTC_COMBO_IRQ input is selected; 45=ARM_TXEV input is selected; 46=PINT0 GPIO_INT_BMATCH input is selected; 49=CMP0_OUT input is selected; 50=usb0 start of frame input is selected; 51=usb1 start of frame input is selected; 52=OSTIMER0 OS_EVENT_TIMER_IRQ input is selected; 53=ADC1_IRQ input is selected; 54=CMP0_IRQ/CMP1_IRQ input is selected; 57=PWM0_IRQ input is selected; 58=PWM1_IRQ input is selected; 59=ENC0_IRQ input is selected; 60=ENC1_IRQ input is selected; 61=EVTG_OUT0A input is selected; 62=EVTG_OUT1A input is selected; 65=GPIO1_alias0 GPIO1 Pin Event Trig 0 input is selected; 66=GPIO1_alias1 GPIO1 Pin Event Trig 1 input is selected; 67=GPIO2_alias0 GPIO2 Pin Event Trig 0 input is selected; 68=GPIO2_alias1 GPIO2 Pin Event Trig 1 input is selected; 69=GPIO3_alias0 GPIO3 Pin Event Trig 0 input is selected; 70=GPIO3_alias1 GPIO3 Pin Event Trig 1 input is selected; {v}=FlexIO Shifter DMA Request {v-71} is selected (v=71..77); 120=FlexIO Shifter DMA Request 7 is selected
{0xC0+4i} PINTSEL[{i}] (i=0..7) reset 0x7F — Pin Interrupt Select
  [6:0] INP — Pin number select for pin interrupt or pattern match engine input. For PIOx_y: INP = (x * 32) + y. PIO0_0 to PIO1_31 correspond to numbers 0 to 63.
    {v}=GPIO P0_{v} input is selected (v=0..7); {v}=GPIO P0_{v} input is selected (v=12..29); {v}=GPIO P1_{v-32} input is selected (v=32..51); 62=GPIO P1_30 input is selected; 63=GPIO P1_31 input is selected
0x180 FREQMEAS_REF reset 0x3F — Selection for Frequency Measurement Reference Clock
  [5:0] INP — Clock source number (binary value) for frequency measure function reference clock.
    0=clk_in (output of clk_in or XTAL mux in Clockgen) input is selected; 1=FRO_12M input is selected; 2=FRO_144M input is selected; 4=OSC_32K input is selected; 5=CPU/system_clk input is selected; 6=FREQME_CLK_IN0 input is selected; 7=FREQME_CLK_IN1 input is selected; 8=EVTG_OUT0A input is selected; 9=EVTG_OUT1A input is selected
0x184 FREQMEAS_TAR reset 0x3F — Selection for Frequency Measurement Target Clock
  [5:0] INP — Clock source number (binary value) for frequency measure function target clock.
    values as FREQMEAS_REF.INP
{0x1A0+4i} CTIMER3CAP{i} reset 0x7F (i=0..3) — Capture Select Register for CTIMER Inputs
  [6:0] INP — Input number for CTIMER
    {v}=CT_INP{v} input is selected (v=0..19); 20=usb0 start of frame input is selected; 21=usb1 start of frame input is selected; 22=DCDC_BURST_ACTIVE input is selected; 23=sai0_tx_sync_outsai_tx_sync_out is Transmit Frame Sync for multi-SAI synchronous operation. input is selected; 24=sai0_rx_sync_outsai_rx_sync_out is Receive Frame Sync for multi-SAI synchronous operation. input is selected; 25=ADC0 ADC0_IRQ input is selected; 26=ADC0 ADC1_IRQ input is selected; 27=CMP0_OUT input is selected; 28=CMP1_OUT input is selected; {v}=PWM0_A{v-30}_TRIG0/PWM0_A{v-30}_TRIG1 input is selected (v=30..33); {v}=PWM1_A{v-34}_TRIG0/PWM1_A{v-34}_TRIG1 input is selected (v=34..37); 38=ENC0_CMP/POS_MATCH input is selected; 39=ENC1_CMP/POS_MATCH input is selected; 40=EVTG_OUT0A input is selected; 41=EVTG_OUT0B input is selected; 42=EVTG_OUT1A input is selected; 43=EVTG_OUT1B input is selected; 44=EVTG_OUT2A input is selected; 45=EVTG_OUT2B input is selected; 46=EVTG_OUT3A input is selected; 47=EVTG_OUT3B input is selected; 50=LP_FLEXCOMM0 trig 0 input is selected; 51=LP_FLEXCOMM0 trig 1 input is selected; 52=LP_FLEXCOMM0 trig 2 input is selected; 53=LP_FLEXCOMM1 trig 0 input is selected; 54=LP_FLEXCOMM1 trig 1 input is selected; 55=LP_FLEXCOMM1 trig 2 input is selected; 56=LP_FLEXCOMM2 trig 0 input is selected; 57=LP_FLEXCOMM2 trig 1 input is selected; 58=LP_FLEXCOMM2 trig 2 input is selected; {v}=LP_FLEXCOMM3 trig {v-59} input is selected (v=59..62); 63=sai1_tx_sync_outsai_tx_sync_out is Transmit Frame Sync for multi-SAI synchronous operation. input is selected; 64=sai1_rx_sync_outsai_rx_sync_out is Receive Frame Sync for multi-SAI synchronous operation. input is selected
0x1B0 TIMER3TRIG reset 0x7F — Trigger Register for CTIMER
  fields as CTIMER3CAP0
{0x1C0+4i} CTIMER4CAP{i} reset 0x7F (i=0..3) — Capture Select Register for CTIMER Inputs
  fields as CTIMER3CAP0
0x1D0 TIMER4TRIG reset 0x7F — Trigger Register for CTIMER
  fields as CTIMER3CAP0
0x260 CMP0_TRIG reset 0x3F — CMP0 Input Connections
  [5:0] TRIGIN — CMP0 input trigger
    0=PINT PIN_INT0 input is selected; 1=PINT PIN_INT6 input is selected; 5=CTIMER0_MAT3 input is selected; 6=CTIMER1_MAT3 input is selected; 7=CTIMER2_MAT3 input is selected; 8=CTIMER0_MAT0 input is selected; 9=CTIMER4_MAT0 input is selected; 11=ARM_TXEV input is selected; 12=PINT GPIO_INT_BMAT input is selected; 13=ADC0_tcomp[0] input is selected; 14=ADC1_tcomp[0] input is selected; {v}=PWM0_A{v-17}_TRIG0/PWM0_A{v-17}_TRIG1 input is selected (v=17..20); {v}=PWM1_A{v-21}_TRIG0/PWM1_A{v-21}_TRIG1 input is selected (v=21..24); 25=ENC0_CMP/POS_MATCH input is selected; 26=ENC1_CMP/POS_MATCH input is selected; 27=EVTG_OUT0A input is selected; 28=EVTG_OUT0B input is selected; 29=EVTG_OUT1A input is selected; 30=EVTG_OUT1B input is selected; 31=EVTG_OUT2A input is selected; 32=EVTG_OUT2B input is selected; 33=EVTG_OUT3A input is selected; 34=EVTG_OUT3B input is selected; 35=LPTMR0 input is selected; 36=LPTMR1 input is selected; 37=GPIO2 Pin Event Trig 0 input is selected; 38=GPIO2 Pin Event Trig 1 input is selected; 39=GPIO3 Pin Event Trig 0 input is selected; 40=GPIO3 Pin Event Trig 1 input is selected
{0x280+4i} ADC0_TRIG[{i}] (i=0..3) reset 0x7F — ADC Trigger Input Connections
  [7:0] TRIGIN — ADC0 trigger inputs
    0=PINT PIN_INT0 input is selected; 1=PINT PIN_INT1 input is selected; {v}=CTIMER{v-5}_MAT3 input is selected (v=5..9); 10=DCDC_Burst_Done_Trig input is selected; 11=ARM_TXEV input is selected; 12=PINT GPIO_INT_BMAT input is selected; {v}=ADC0_tcomp[{v-13}] input is selected (v=13..16); {v}=ADC1_tcomp[{v-17}] input is selected (v=17..20); 21=CMP0_OUT input is selected; 22=CMP1_OUT input is selected; 24=PWM0_A0_TRIG0 input is selected; 25=PWM0_A0_TRIG1 input is selected; 26=PWM0_A1_TRIG0 input is selected; 27=PWM0_A1_TRIG1 input is selected; 28=PWM0_A2_TRIG0 input is selected; 29=PWM0_A2_TRIG1 input is selected; 30=PWM0_A3_TRIG0 input is selected; 31=PWM0_A3_TRIG1 input is selected; 32=PWM1_A0_TRIG0 input is selected; 33=PWM1_A0_TRIG1 input is selected; 34=PWM1_A1_TRIG0 input is selected; 35=PWM1_A1_TRIG1 input is selected; 36=PWM1_A2_TRIG0 input is selected; 37=PWM1_A2_TRIG1 input is selected; 38=PWM1_A3_TRIG0 input is selected; 39=PWM1_A3_TRIG1 input is selected; 40=ENC0_CMP/POS_MATCH input is selected; 41=ENC1_CMP/POS_MATCH input is selected; 42=EVTG_OUT0A input is selected; 43=EVTG_OUT0B input is selected; 44=EVTG_OUT1A input is selected; 45=EVTG_OUT1B input is selected; 46=EVTG_OUT2A input is selected; 47=EVTG_OUT2B input is selected; 48=EVTG_OUT3A input is selected; 49=EVTG_OUT3B input is selected; 50=LPTMR0 input is selected; 51=LPTMR1 input is selected; {v}=FlexIO CH{v-52} input is selected (v=52..55); 61=GPIO2 Pin Event Trig 0 input is selected; 62=GPIO2 Pin Event Trig 1 input is selected; 63=GPIO3 Pin Event Trig 0 input is selected; 64=GPIO3 Pin Event Trig 1 input is selected; 65=WUU input is selected
{0x2C0+4i} ADC1_TRIG[{i}] (i=0..3) reset 0x7F — ADC Trigger Input Connections
  [7:0] TRIGIN — ADC1 trigger inputs
    0=PINT PIN_INT0 input is selected; 1=PINT PIN_INT2 input is selected; 5=CTIMER0_MAT3 input is selected; 6=CTIMER1_MAT3 input is selected; 7=CTIMER2_MAT3 input is selected; 8=CTIMER3_MAT2 input is selected; 9=CTIMER4_MAT1 input is selected; 10=DCDC_Burst_Done_Trig input is selected; 11=ARM_TXEV input is selected; 12=PINT GPIO_INT_BMAT input is selected; {v}=ADC0_tcomp[{v-13}] input is selected (v=13..16); {v}=ADC1_tcomp[{v-17}] input is selected (v=17..20); 21=CMP0_OUT input is selected; 22=CMP1_OUT input is selected; 24=PWM0_A0_TRIG0 input is selected; 25=PWM0_A0_TRIG1 input is selected; 26=PWM0_A1_TRIG0 input is selected; 27=PWM0_A1_TRIG1 input is selected; 28=PWM0_A2_TRIG0 input is selected; 29=PWM0_A2_TRIG1 input is selected; 30=PWM0_A3_TRIG0 input is selected; 31=PWM0_A3_TRIG1 input is selected; 32=PWM1_A0_TRIG0 input is selected; 33=PWM1_A0_TRIG1 input is selected; 34=PWM1_A1_TRIG0 input is selected; 35=PWM1_A1_TRIG1 input is selected; 36=PWM1_A2_TRIG0 input is selected; 37=PWM1_A2_TRIG1 input is selected; 38=PWM1_A3_TRIG0 input is selected; 39=PWM1_A3_TRIG1 input is selected; 40=ENC0_CMP/POS_MATCH input is selected; 41=ENC1_CMP/POS_MATCH input is selected; 42=EVTG_OUT0A input is selected; 43=EVTG_OUT0B input is selected; 44=EVTG_OUT1A input is selected; 45=EVTG_OUT1B input is selected; 46=EVTG_OUT2A input is selected; 47=EVTG_OUT2B input is selected; 48=EVTG_OUT3A input is selected; 49=EVTG_OUT3B input is selected; 50=LPTMR0 input is selected; 51=LPTMR1 input is selected; {v}=FlexIO CH{v-52} input is selected (v=52..55); 61=GPIO2 Pin Event Trig 0 input is selected; 62=GPIO2 Pin Event Trig 1 input is selected; 63=GPIO3 Pin Event Trig 0 input is selected; 64=GPIO3 Pin Event Trig 1 input is selected; 65=WUU input is selected
{0x3A0+4i} FlexPWM0_SM_EXTSYNC[{i}] (i=0..3) reset 0x3F — PWM0 External Synchronization
  [5:0] TRIGIN — EXTSYNC input connections for PWM0
    0=PINT PIN_INT0 input is selected; 1=PINT PIN_INT5 input is selected; 5=CTIMER0_MAT3 input is selected; 6=CTIMER1_MAT3 input is selected; 7=CTIMER2_MAT3 input is selected; 8=CTIMER2_MAT0 input is selected; 9=CTIMER4_MAT0 input is selected; 11=ARM_TXEV input is selected; 12=PINT GPIO_INT_BMAT input is selected; {v}=ADC0_tcomp[{v-13}] input is selected (v=13..16); {v}=ADC1_tcomp[{v-17}] input is selected (v=17..20); 21=CMP0_OUT input is selected; 22=CMP1_OUT input is selected; 24=PWM1_A0_TRIG0 input is selected; 25=PWM1_A0_TRIG1 input is selected; 26=PWM1_A1_TRIG0 input is selected; 27=PWM1_A1_TRIG1 input is selected; 28=PWM1_A2_TRIG0 input is selected; 29=PWM1_A2_TRIG1 input is selected; 30=PWM1_A3_TRIG0 input is selected; 31=PWM1_A3_TRIG1 input is selected; 32=ENC0_CMP/POS_MATCH input is selected; 33=ENC1_CMP/POS_MATCH input is selected; 34=EVTG_OUT0A input is selected; 35=EVTG_OUT0B input is selected; 36=EVTG_OUT1A input is selected; 37=EVTG_OUT1B input is selected; 38=EVTG_OUT2A input is selected; 39=EVTG_OUT2B input is selected; 40=EVTG_OUT3A input is selected; 41=EVTG_OUT3B input is selected; {v}=TRIG_IN{v-42} input is selected (v=42..51); 57=GPIO2 Pin Event Trig 0 input is selected; 58=GPIO2 Pin Event Trig 1 input is selected; 59=GPIO3 Pin Event Trig 0 input is selected; 60=GPIO3 Pin Event Trig 1 input is selected
{0x3B0+4i} FlexPWM0_SM_EXTA[{i}] (i=0..3) reset 0x3F — PWM0 Input Trigger Connections
  [5:0] TRIGIN — EXTA input connections for PWM0
    values as FlexPWM0_SM_EXTSYNC[0].TRIGIN
0x3C0 FlexPWM0_EXTFORCE reset 0x3F — PWM0 External Force Trigger Connections
  [5:0] TRIGIN — EXTFORCE input connections for PWM0
    values as FlexPWM0_SM_EXTSYNC[0].TRIGIN
{0x3C4+4i} FlexPWM0_FAULT[{i}] (i=0..3) reset 0x3F — PWM0 Fault Input Trigger Connections
  [5:0] TRIGIN — FAULT input connections for PWM0
    values as FlexPWM0_SM_EXTSYNC[0].TRIGIN
{0x3E0+4i} FlexPWM1_SM_EXTSYNC[{i}] (i=0..3) reset 0x3F — PWM1 External Synchronization
  [5:0] TRIGIN — EXTSYNC input connections for PWM1
    0=PINT PIN_INT0 input is selected; 1=PINT PIN_INT2 input is selected; 5=CTIMER0_MAT3 input is selected; 6=CTIMER1_MAT3 input is selected; 7=CTIMER2_MAT3 input is selected; 8=CTIMER2_MAT1 input is selected; 9=CTIMER4_MAT1 input is selected; 11=ARM_TXEV input is selected; 12=PINT GPIO_INT_BMAT input is selected; {v}=ADC0_tcomp[{v-13}] input is selected (v=13..16); {v}=ADC1_tcomp[{v-17}] input is selected (v=17..20); 21=CMP0_OUT input is selected; 22=CMP1_OUT input is selected; 24=PWM0_A0_TRIG0 input is selected; 25=PWM0_A0_TRIG1 input is selected; 26=PWM0_A1_TRIG0 input is selected; 27=PWM0_A1_TRIG1 input is selected; 28=PWM0_A2_TRIG0 input is selected; 29=PWM0_A2_TRIG1 input is selected; 30=PWM0_A3_TRIG0 input is selected; 31=PWM0_A3_TRIG1 input is selected; 32=ENC0_CMP/POS_MATCH input is selected; 33=ENC1_CMP/POS_MATCH input is selected; 34=EVTG_OUT0A input is selected; 35=EVTG_OUT0B input is selected; 36=EVTG_OUT1A input is selected; 37=EVTG_OUT1B input is selected; 38=EVTG_OUT2A input is selected; 39=EVTG_OUT2B input is selected; 40=EVTG_OUT3A input is selected; 41=EVTG_OUT3B input is selected; {v}=TRIG_IN{v-42} input is selected (v=42..51); 57=GPIO2 Pin Event Trig 0 input is selected; 58=GPIO2 Pin Event Trig 1 input is selected; 59=GPIO3 Pin Event Trig 0 input is selected; 60=GPIO3 Pin Event Trig 1 input is selected
{0x3F0+4i} FlexPWM1_SM_EXTA[{i}] (i=0..3) reset 0x3F — PWM1 Input EXTA Connections
  [5:0] TRIGIN — EXTA input connections for PWM1
    values as FlexPWM1_SM_EXTSYNC[0].TRIGIN
0x400 FlexPWM1_EXTFORCE reset 0x3F — PWM1 External Force Trigger Connections
  [5:0] TRIGIN — EXTFORCE input connections for PWM1
    values as FlexPWM1_SM_EXTSYNC[0].TRIGIN
{0x404+4i} FlexPWM1_FAULT[{i}] (i=0..3) reset 0x3F — PWM1 Fault Input Trigger Connections
  [5:0] TRIGIN — FAULT input connections for PWM1
    values as FlexPWM1_SM_EXTSYNC[0].TRIGIN
0x420 PWM0_EXT_CLK reset 0x7 — PWM0 External Clock Trigger
  [2:0] TRIGIN — EXT_CLK input connections for PWM0
    0=FRO16K input is selected; 1=OSC_32k input is selected; 2=EVTG_OUT0A input is selected; 3=EVTG_OUT1A input is selected; 4=TRIG_IN0 input is selected; 5=TRIG_IN7 input is selected
0x424 PWM1_EXT_CLK reset 0x7 — PWM1 External Clock Trigger
  [3:0] TRIGIN — EXT_CLK input connections for PWM1
    values as PWM0_EXT_CLK.TRIGIN
{0x440+4i} EVTG_TRIG[{i}] (i=0..15) reset 0x3F — EVTG Trigger Input Connections
  [5:0] INP — EVTG trigger input connections
    0=PINT PIN_INT0 input is selected; 1=PINT PIN_INT1 input is selected; 6=CTIMER0_MAT3 input is selected; 7=CTIMER1_MAT3 input is selected; 8=CTIMER2_MAT3 input is selected; 9=CTIMER2_MAT2 input is selected; 10=CTIMER3_MAT2 input is selected; 11=CTIMER4_MAT2 input is selected; 13=PINT GPIO_INT_BMAT input is selected; 14=ADC0_IRQ input is selected; 15=ADC1_IRQ input is selected; {v}=ADC0_tcomp[{v-16}] input is selected (v=16..19); {v}=ADC1_tcomp[{v-20}] input is selected (v=20..23); 24=CMP0_OUT input is selected; 25=CMP1_OUT input is selected; 27=PWM0_A0_TRIG0 input is selected; 28=PWM0_A0_TRIG1 input is selected; 29=PWM0_A1_TRIG0 input is selected; 30=PWM0_A1_TRIG1 input is selected; 31=PWM0_A2_TRIG0 input is selected; 32=PWM0_A2_TRIG1 input is selected; 33=PWM0_A3_TRIG0 input is selected; 34=PWM0_A3_TRIG1 input is selected; 35=PWM1_A0_TRIG0 input is selected; 36=PWM1_A0_TRIG1 input is selected; 37=PWM1_A1_TRIG0 input is selected; 38=PWM1_A1_TRIG1 input is selected; 39=PWM1_A2_TRIG0 input is selected; 40=PWM1_A2_TRIG1 input is selected; 41=PWM1_A3_TRIG0 input is selected; 42=PWM1_A3_TRIG1 input is selected; 43=ENC0_CMP/POS_MATCH input is selected; 44=ENC1_CMP/POS_MATCH input is selected; {v}=TRIG_IN{v-45} input is selected (v=45..48); 49=LPTMR0 input is selected; 50=LPTMR1 input is selected
{0x4C0+4i} EXT_TRIG[{i}] (i=0..7) reset 0x3F — EXT Trigger Connections
  [5:0] INP — EXT trigger input connections
    0=PINT PIN_INT0 input is selected; 1=PINT PIN_INT1 input is selected; 2=ADC0_IRQ input is selected; 3=ADC1_IRQ input is selected; 4=ADC0_tcomp[0] input is selected; 5=ADC1_tcomp[0] input is selected; {v}=PWM0_A{v-6}_TRIG0/PWM0_A{v-6}_TRIG1 input is selected (v=6..9); {v}=PWM1_A{v-10}_TRIG0/PWM1_A{v-10}_TRIG1 input is selected (v=10..13); 14=ENC0_CMP/POS_MATCH input is selected; 15=ENC1_CMP/POS_MATCH input is selected; 16=EVTG_OUT0A input is selected; 17=EVTG_OUT0B input is selected; 18=EVTG_OUT1A input is selected; 19=EVTG_OUT1B input is selected; 20=EVTG_OUT2A input is selected; 21=EVTG_OUT2B input is selected; 22=EVTG_OUT3A input is selected; 23=EVTG_OUT3B input is selected; 26=LPTMR0 input is selected; 27=LPTMR1 input is selected; {v}=LP_FLEXCOMM{v-34} trigger output 3 input is selected (v=34..41); 44=CMP0_OUT input is selected; 45=CMP1_OUT input is selected
0x4E0 CMP1_TRIG reset 0x3F — CMP1 Input Connections
  [5:0] TRIGIN — CMP1 input trigger
    0=PINT PIN_INT0 input is selected; 1=PINT PIN_INT7 input is selected; 5=CTIMER0_MAT3 input is selected; 6=CTIMER1_MAT3 input is selected; 7=CTIMER2_MAT3 input is selected; 8=CTIMER3_MAT1 input is selected; 9=CTIMER4_MAT1 input is selected; 11=ARM_TXEV input is selected; 12=PINT GPIO_INT_BMAT input is selected; 13=ADC0_tcomp[1] input is selected; 14=ADC1_tcomp[1] input is selected; {v}=PWM0_A{v-17}_TRIG0/PWM0_A{v-17}_TRIG1 input is selected (v=17..20); {v}=PWM1_A{v-21}_TRIG0/PWM1_A{v-21}_TRIG1 input is selected (v=21..24); 25=ENC0_CMP/POS_MATCH input is selected; 26=ENC1_CMP/POS_MATCH input is selected; 27=EVTG_OUT0A input is selected; 28=EVTG_OUT0B input is selected; 29=EVTG_OUT1A input is selected; 30=EVTG_OUT1B input is selected; 31=EVTG_OUT2A input is selected; 32=EVTG_OUT2B input is selected; 33=EVTG_OUT3A input is selected; 34=EVTG_OUT3B input is selected; 35=LPTMR0 input is selected; 36=LPTMR1 input is selected; 37=GPIO2 Pin Event Trig 0 input is selected; 38=GPIO2 Pin Event Trig 1 input is selected; 39=GPIO3 Pin Event Trig 0 input is selected; 40=GPIO3 Pin Event Trig 1 input is selected
0x5A0 FLEXCOMM0_TRIG reset 0x3F — LP_FLEXCOMM0 Trigger Input Connections
  [5:0] INP — LP_FLEXCOMM0 trigger input connections
    0=PINT PIN_INT4 input is selected; 1=PINT PIN_INT5 input is selected; 2=PINT PIN_INT6 input is selected; 6=CTIMER0_MAT1 input is selected; 7=CTIMER1_MAT1 input is selected; 8=CTIMER2_MAT0 input is selected; 9=CTIMER3_MAT0 input is selected; 10=CTIMER4_MAT0 input is selected; 11=LPTMR0 input is selected; 12=LPTMR1 input is selected; 13=ARM_TXEV input is selected; 14=PINT GPIO_INT_BMAT input is selected; 15=CMP0_OUT input is selected; 16=CMP1_OUT input is selected; 18=EVTG_OUT0A input is selected; 19=EVTG_OUT0B input is selected; 20=EVTG_OUT1A input is selected; 21=EVTG_OUT1B input is selected; 22=EVTG_OUT2A input is selected; 23=EVTG_OUT2B input is selected; 24=EVTG_OUT3A input is selected; 25=EVTG_OUT3B input is selected; {v}=TRIG_IN{v-26} input is selected (v=26..30); 31=TRIG_IN10 input is selected; 32=TRIG_IN11 input is selected; {v}=FlexIO CH{v-29} input is selected (v=33..36); 37=USB0 ipp_ind_uart_rxd_usbmux input is selected; 38=GPIO2 Pin Event Trig 0 input is selected; 39=GPIO2 Pin Event Trig 1 input is selected; 40=GPIO3 Pin Event Trig 0 input is selected; 41=GPIO3 Pin Event Trig 1 input is selected; 42=WUU input is selected
0x5C0 FLEXCOMM1_TRIG reset 0x3F — LP_FLEXCOMM1 Trigger Input Connections
  [5:0] INP — LP_FLEXCOMM1 trigger input connections
    values as FLEXCOMM0_TRIG.INP
0x5E0 FLEXCOMM2_TRIG reset 0x3F — LP_FLEXCOMM2 Trigger Input Connections
  [5:0] INP — LP_FLEXCOMM2 trigger input connections
    0=PINT PIN_INT4 input is selected; 1=PINT PIN_INT6 input is selected; 2=PINT PIN_INT7 input is selected; {v}=CTIMER{v-6}_MAT1 input is selected (v=6..10); 11=LPTMR0 input is selected; 12=LPTMR1 input is selected; 13=ARM_TXEV input is selected; 14=PINT GPIO_INT_BMAT input is selected; 15=CMP0_OUT input is selected; 16=CMP1_OUT input is selected; 18=EVTG_OUT0A input is selected; 19=EVTG_OUT0B input is selected; 20=EVTG_OUT1A input is selected; 21=EVTG_OUT1B input is selected; 22=EVTG_OUT2A input is selected; 23=EVTG_OUT2B input is selected; 24=EVTG_OUT3A input is selected; 25=EVTG_OUT3B input is selected; {v}=TRIG_IN{v-26} input is selected (v=26..30); 31=TRIG_IN10 input is selected; 32=TRIG_IN11 input is selected; {v}=FlexIO CH{v-29} input is selected (v=33..36); 37=USB0 ipp_ind_uart_rxd_usbmux input is selected; 38=GPIO2 Pin Event Trig 0 input is selected; 39=GPIO2 Pin Event Trig 1 input is selected; 40=GPIO3 Pin Event Trig 0 input is selected; 41=GPIO3 Pin Event Trig 1 input is selected; 42=WUU input is selected
