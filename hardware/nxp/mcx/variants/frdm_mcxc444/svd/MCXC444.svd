# MCXC444 register map
Vendor: NXP Semiconductors; Series: MCX; File version: 1.6
MCXC444 NXP Microcontroller
CPU: CM0PLUS r0p0, little endian, no MPU, no FPU, VTOR, 2 interrupt priority bits
Registers are 32-bit, read-write, reset 0x0 unless marked. A register's access mark holds for its fields unless they carry their own. Offsets are from the block's base; lines under a group give offsets from that group; [hi:lo] are bit positions; {n}, {i} and the like mark numbered series; 'fields as' and 'values as' point back to an identical list; <NAME> marks a mode.

## Memory map
0x00000400 FTFA_FlashConfig size 0xE — Flash configuration field
0x40008000 DMA blocks up to offset 0x140 — DMA Controller
0x40020000 FTFA size 0x14 — Flash Memory Interface
0x40021000 DMAMUX0 size 0x4 — DMA channel multiplexor
0x4002F000 I2S0 size 0x104 — Inter-IC Sound / Synchronous Audio Interface
0x40037000 PIT size 0x120 — Periodic Interrupt Timer
0x40038000 TPM0 size 0x88 — Timer/PWM Module
0x40039000 TPM1 size 0x88 — Timer/PWM Module
0x4003A000 TPM2 size 0x88 — Timer/PWM Module
0x4003B000 ADC0 size 0x70 — Analog-to-Digital Converter
0x4003D000 RTC size 0x20 — Secure Real Time Clock
0x4003F000 DAC0 size 0x24 — 12-Bit Digital-to-Analog Converter
0x40040000 LPTMR0 size 0x10 — Low Power Timer
0x40041000 RFSYS size 0x20 — System register file
0x40047000 SIM size 0x1108 — System Integration Module
0x40049000 PORTA size 0xA4 — Pin Control and Interrupts
0x4004A000 PORTB size 0xA4 — Pin Control and Interrupts
0x4004B000 PORTC size 0xA4 — Pin Control and Interrupts
0x4004C000 PORTD size 0xA4 — Pin Control and Interrupts
0x4004D000 PORTE size 0xA4 — Pin Control and Interrupts
0x40053000 LCD size 0x60 — Segment Liquid Crystal Display
0x40054000 LPUART0 size 0x14 — Universal Asynchronous Receiver/Transmitter
0x40055000 LPUART1 size 0x14 — Universal Asynchronous Receiver/Transmitter
0x4005F000 FLEXIO size 0x510 — Flexible I/O - universal I/O module for communication (UART, SPI, I2C, I2S) and PWM purposes.
0x40064000 MCG size 0x1C — Multipurpose Clock Generator Lite
0x40065000 OSC0 size 0x1 — Oscillator
0x40066000 I2C0 size 0xD — Inter-Integrated Circuit
0x40067000 I2C1 size 0xD — Inter-Integrated Circuit
0x4006C000 UART2 size 0x40 — Serial Communication Interface
0x40072000 USB0 size 0x15D — Universal Serial Bus, OTG Capable Controller
0x40073000 CMP0 size 0x6 — High-Speed Comparator (CMP), Voltage Reference (VREF) Digital-to-Analog Converter (DAC), and Analog Mux (ANMUX)
0x40074000 VREF size 0x2 — Voltage Reference
0x40076000 SPI0 size 0x8 — Serial Peripheral Interface
0x40077000 SPI1 size 0xC — Serial Peripheral Interface
0x4007C000 LLWU size 0xA — Low leakage wakeup unit
0x4007D000 PMC size 0x3 — Power Management Controller
0x4007E000 SMC size 0x4 — System Mode Controller
0x4007F000 RCM size 0xA — Reset Control Module
0x400FF000 GPIOA size 0x18 — General Purpose Input/Output
0x400FF040 GPIOB size 0x18 — General Purpose Input/Output
0x400FF080 GPIOC size 0x18 — General Purpose Input/Output
0x400FF0C0 GPIOD size 0x18 — General Purpose Input/Output
0x400FF100 GPIOE size 0x18 — General Purpose Input/Output
0xE000E000 SystemControl blocks up to offset 0xD34 — System Control Block
0xE000E010 SysTick size 0x10 — System timer
0xE000E100 NVIC size 0x320 — Nested Vectored Interrupt Controller
0xF0000000 MTB size 0x1000 — Micro Trace Buffer
0xF0001000 MTBDWT size 0x1000 — MTB data watchpoint and trace
0xF0002000 ROM size 0x1000 — System ROM
0xF0003000 MCM blocks up to offset 0x44 — Core Platform Miscellaneous Control Module
0xF8000000 FGPIOA size 0x18 — General Purpose Input/Output
0xF8000040 FGPIOB size 0x18 — General Purpose Input/Output
0xF8000080 FGPIOC size 0x18 — General Purpose Input/Output
0xF80000C0 FGPIOD size 0x18 — General Purpose Input/Output
0xF8000100 FGPIOE size 0x18 — General Purpose Input/Output

## Interrupts
0 DMA0 (DMA)
1 DMA1 (DMA)
2 DMA2 (DMA)
3 DMA3 (DMA)
5 FTFA
6 PMC
7 LLWU
8 I2C0
9 I2C1
10 SPI0
11 SPI1
12 LPUART0
13 LPUART1
14 UART2_FLEXIO (FLEXIO, UART2)
15 ADC0
16 CMP0
17 TPM0
18 TPM1
19 TPM2
20 RTC
21 RTC_Seconds (RTC)
22 PIT
23 I2S0
24 USB0
25 DAC0
28 LPTMR0
29 LCD
30 PORTA (PORTA, GPIOA)
31 PORTC_PORTD (PORTC, PORTD, GPIOC, GPIOD)

## Licence text in the file
Copyright 2016-2024 NXP. SPDX-License-Identifier: BSD-3-Clause
