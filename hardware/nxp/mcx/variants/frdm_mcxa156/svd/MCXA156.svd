# MCXA156 register map
Vendor: nxp.com; File version: 1.0
CPU: CM33 r2p0, little endian, no MPU, FPU, VTOR, 3 interrupt priority bits
Registers are 32-bit, read-write, reset 0x0 unless marked. A register's access mark holds for its fields unless they carry their own. Offsets are from the block's base; [hi:lo] are bit positions; {n}, {i} and the like mark numbered series; 'fields as' and 'values as' point back to an identical list.

## INPUTMUX0 — INPUTMUX
Base 0x40001000
{0x20+4i} CTIMER0CAP[{i}] (i=0..3) reset 0x7F — Capture select register for CTIMER inputs
  [6:0] INP — Input number for CTIMER0
    {v}=CT_IPN{v-1} input is selected (v=1..20); 21=USB0 usb0 start of frame input is selected; {v}=AOI0_OUT{v-22} input is selected (v=22..25); 26=ADC0_tcomp[0]; 27=ADC0_tcomp[1]; 28=ADC0_tcomp[2]; 29=ADC0_tcomp[3] input is selected; 30=CMP0_OUT is selected; 31=CMP1_OUT is selected; 33=CTimer1_MAT1 input is selected; 34=CTimer1_MAT2 input is selected; 35=CTimer1_MAT3 input is selected; 36=CTimer2_MAT1 input is selected; 37=CTimer2_MAT2 input is selected; 38=CTimer2_MAT3 input is selected; 39=QDC0_CMP_FLAG0 is selected; 40=QDC0_CMP_FLAG1 input is selected; 41=QDC0_CMP_FLAG2 input is selected; 42=QDC0_CMP_FLAG3 input is selected; 43=QDC0_POS_MATCH0 input is selected; 44=PWM0_SM0_MUX_TRIG0 input is selected; 45=PWM0_SM1_MUX_TRIG0 input is selected; 46=PWM0_SM2_MUX_TRIG0 input is selected; 48=LPI2C0 Master End of Packet input is selected; 49=LPI2C0 Slave End of Packet input is selected; 50=LPI2C1 Master End of Packet input is selected; 51=LPI2C1 Slave End of Packet input is selected; 52=LPSPI0 End of Frame input is selected; 53=LPSPI0 Received Data Word input is selected; 54=LPSPI1 End of Frame input is selected; 55=LPSPI1 Received Data Word input is selected; 56=LPUART0 Received Data Word input is selected; 57=LPUART0 Transmitted Data Word input is selected; 58=LPUART0 Receive Line Idle input is selected; 59=LPUART1 Received Data Word input is selected; 60=LPUART1 Transmitted Data Word input is selected; 61=LPUART1 Receive Line Idle input is selected; 62=LPUART2 Received Data Word input is selected; 63=LPUART2 Transmitted Data Word input is selected; 64=LPUART2 Receive Line Idle input is selected; 65=LPUART3 Received Data Word input is selected; 66=LPUART3 Transmitted Data Word input is selected; 67=LPUART3 Receive Line Idle input is selected; 68=LPUART4 Received Data Word input is selected; 69=LPUART4 Transmitted Data Word input is selected; 70=LPUART4 Receive Line Idle input is selected; {v}=AOI1_OUT{v-71} input is selected (v=71..74); {v}=ADC1_tcomp[{v-75}] input is selected (v=75..78); 79=CTimer3_MAT1 input is selected; 80=CTimer3_MAT2 input is selected; 81=CTimer3_MAT3 input is selected; 82=CTimer4_MAT1 input is selected; 83=CTimer4_MAT2 input is selected; 84=CTimer4_MAT3 input is selected; {v}=QDC1_CMP_FLAG{v-85} input is selected (v=85..88); 89=QDC1_POS_MATCH0 input is selected; 90=PWM1_SM0_MUX_TRIG0 input is selected; 91=PWM1_SM1_MUX_TRIG0 input is selected; 92=PWM1_SM2_MUX_TRIG0 input is selected; 94=LPI2C2 Master End of Packet input is selected; 95=LPI2C2 Slave End of Packet input is selected; 96=LPI2C3 Master End of Packet input is selected; 97=LPI2C3 Slave End of Packet input is selected
0x30 TIMER0TRIG reset 0x7F — Trigger register for TIMER0
  fields as CTIMER0CAP[0]
{0x40+4i} CTIMER1CAP[{i}] (i=0..3) reset 0x7F — Capture select register for CTIMER inputs
  [6:0] INP — Input number for CTIMER1
    {v}=CT_IPN{v-1} input is selected (v=1..20); 21=USB0 usb0 start of frame input is selected; {v}=AOI0_OUT{v-22} input is selected (v=22..25); 26=ADC0_tcomp[0]; 27=ADC0_tcomp[1]; 28=ADC0_tcomp[2]; 29=ADC0_tcomp[3] input is selected; 30=CMP0_OUT is selected; 31=CMP1_OUT is selected; 33=CTimer0_MAT1 input is selected; 34=CTimer0_MAT2 input is selected; 35=CTimer0_MAT3 input is selected; 36=CTimer2_MAT1 input is selected; 37=CTimer2_MAT2 input is selected; 38=CTimer2_MAT3 input is selected; 39=QDC0_CMP_FLAG0 is selected; 40=QDC0_CMP_FLAG1 input is selected; 41=QDC0_CMP_FLAG2 input is selected; 42=QDC0_CMP_FLAG3 input is selected; 43=QDC0_POS_MATCH0 input is selected; 44=PWM0_SM0_MUX_TRIG0 input is selected; 45=PWM0_SM1_MUX_TRIG0 input is selected; 46=PWM0_SM2_MUX_TRIG0 input is selected; 48=LPI2C0 Master End of Packet input is selected; 49=LPI2C0 Slave End of Packet input is selected; 50=LPI2C1 Master End of Packet input is selected; 51=LPI2C1 Slave End of Packet input is selected; 52=LPSPI0 End of Frame input is selected; 53=LPSPI0 Received Data Word input is selected; 54=LPSPI1 End of Frame input is selected; 55=LPSPI1 Received Data Word input is selected; 56=LPUART0 Received Data Word input is selected; 57=LPUART0 Transmitted Data Word input is selected; 58=LPUART0 Receive Line Idle input is selected; 59=LPUART1 Received Data Word input is selected; 60=LPUART1 Transmitted Data Word input is selected; 61=LPUART1 Receive Line Idle input is selected; 62=LPUART2 Received Data Word input is selected; 63=LPUART2 Transmitted Data Word input is selected; 64=LPUART2 Receive Line Idle input is selected; 65=LPUART3 Received Data Word input is selected; 66=LPUART3 Transmitted Data Word input is selected; 67=LPUART3 Receive Line Idle input is selected; 68=LPUART4 Received Data Word input is selected; 69=LPUART4 Transmitted Data Word input is selected; 70=LPUART4 Receive Line Idle input is selected; {v}=AOI1_OUT{v-71} input is selected (v=71..74); {v}=ADC1_tcomp[{v-75}] input is selected (v=75..78); 79=CTimer3_MAT1 input is selected; 80=CTimer3_MAT2 input is selected; 81=CTimer3_MAT3 input is selected; 82=CTimer4_MAT1 input is selected; 83=CTimer4_MAT2 input is selected; 84=CTimer4_MAT3 input is selected; {v}=QDC1_CMP_FLAG{v-85} input is selected (v=85..88); 89=QDC1_POS_MATCH0 input is selected; 90=PWM1_SM0_MUX_TRIG0 input is selected; 91=PWM1_SM1_MUX_TRIG0 input is selected; 92=PWM1_SM2_MUX_TRIG0 input is selected; 94=LPI2C2 Master End of Packet input is selected; 95=LPI2C2 Slave End of Packet input is selected; 96=LPI2C3 Master End of Packet input is selected; 97=LPI2C3 Slave End of Packet input is selected
0x50 TIMER1TRIG reset 0x7F — Trigger register for TIMER1
  fields as CTIMER1CAP[0]
{0x60+4i} CTIMER2CAP[{i}] (i=0..3) reset 0x7F — Capture select register for CTIMER inputs
  [6:0] INP — Input number for CTIMER2
    {v}=CT_IPN{v-1} input is selected (v=1..20); 21=USB0 usb0 start of frame input is selected; {v}=AOI0_OUT{v-22} input is selected (v=22..25); 26=ADC0_tcomp[0]; 27=ADC0_tcomp[1]; 28=ADC0_tcomp[2]; 29=ADC0_tcomp[3] input is selected; 30=CMP0_OUT is selected; 31=CMP1_OUT is selected; 33=CTimer0_MAT1 input is selected; 34=CTimer0_MAT2 input is selected; 35=CTimer0_MAT3 input is selected; 36=CTimer1_MAT1 input is selected; 37=CTimer1_MAT2 input is selected; 38=CTimer1_MAT3 input is selected; 39=QDC0_CMP_FLAG0 is selected; 40=QDC0_CMP_FLAG1 input is selected; 41=QDC0_CMP_FLAG2 input is selected; 42=QDC0_CMP_FLAG3 input is selected; 43=QDC0_POS_MATCH0 input is selected; 44=PWM0_SM0_MUX_TRIG0 input is selected; 45=PWM0_SM1_MUX_TRIG0 input is selected; 46=PWM0_SM2_MUX_TRIG0 input is selected; 48=LPI2C0 Master End of Packet input is selected; 49=LPI2C0 Slave End of Packet input is selected; 50=LPI2C1 Master End of Packet input is selected; 51=LPI2C1 Slave End of Packet input is selected; 52=LPSPI0 End of Frame input is selected; 53=LPSPI0 Received Data Word input is selected; 54=LPSPI1 End of Frame input is selected; 55=LPSPI1 Received Data Word input is selected; 56=LPUART0 Received Data Word input is selected; 57=LPUART0 Transmitted Data Word input is selected; 58=LPUART0 Receive Line Idle input is selected; 59=LPUART1 Received Data Word input is selected; 60=LPUART1 Transmitted Data Word input is selected; 61=LPUART1 Receive Line Idle input is selected; 62=LPUART2 Received Data Word input is selected; 63=LPUART2 Transmitted Data Word input is selected; 64=LPUART2 Receive Line Idle input is selected; 65=LPUART3 Received Data Word input is selected; 66=LPUART3 Transmitted Data Word input is selected; 67=LPUART3 Receive Line Idle input is selected; 68=LPUART4 Received Data Word input is selected; 69=LPUART4 Transmitted Data Word input is selected; 70=LPUART4 Receive Line Idle input is selected; {v}=AOI1_OUT{v-71} input is selected (v=71..74); {v}=ADC1_tcomp[{v-75}] input is selected (v=75..78); 79=CTimer3_MAT1 input is selected; 80=CTimer3_MAT2 input is selected; 81=CTimer3_MAT3 input is selected; 82=CTimer4_MAT1 input is selected; 83=CTimer4_MAT2 input is selected; 84=CTimer4_MAT3 input is selected; {v}=QDC1_CMP_FLAG{v-85} input is selected (v=85..88); 89=QDC1_POS_MATCH0 input is selected; 90=PWM1_SM0_MUX_TRIG0 input is selected; 91=PWM1_SM1_MUX_TRIG0 input is selected; 92=PWM1_SM2_MUX_TRIG0 input is selected; 94=LPI2C2 Master End of Packet input is selected; 95=LPI2C2 Slave End of Packet input is selected; 96=LPI2C3 Master End of Packet input is selected; 97=LPI2C3 Slave End of Packet input is selected
0x70 TIMER2TRIG reset 0x7F — Trigger register for TIMER2 inputs
  fields as CTIMER2CAP[0]
0x180 FREQMEAS_REF reset 0x3F — Selection for frequency measurement reference clock
  [6:0] INP — Clock source number (binary value) for frequency measure function target clock.
    1=clk_in input is selected; 2=FRO_OSC_12M input is selected; 3=fro_hf_div input is selected; 5=clk_16k[1] input is selected; 6=SLOW_CLK input is selected; 7=FREQME_CLK_IN0 input is selected; 8=FREQME_CLK_IN1 input is selected input is selected; 9=AOI0_OUT0 input is selected; 10=AOI0_OUT1; 11=PWM0_SM0_MUX_TRIG0; 12=PWM0_SM0_MUX_TRIG1; 13=PWM0_SM1_MUX_TRIG0; 14=PWM0_SM1_MUX_TRIG1; 15=PWM0_SM2_MUX_TRIG0; 16=PWM0_SM2_MUX_TRIG1; 32=AOI1_OUT0 input is selected; 33=AOI1_OUT1 input is selected; 34=PWM1_SM0_MUX_TRIG0 input is selected; 35=PWM1_SM0_MUX_TRIG1 input is selected; 36=PWM1_SM1_MUX_TRIG0 input is selected; 37=PWM1_SM1_MUX_TRIG1 input is selected; 38=PWM1_SM2_MUX_TRIG0 input is selected; 39=PWM1_SM2_MUX_TRIG1 input is selected
0x184 FREQMEAS_TAR reset 0x3F — Selection for frequency measurement reference clock
  fields as FREQMEAS_REF
{0x1A0+4i} CTIMER3CAP[{i}] (i=0..3) reset 0x7F — Capture select register for CTIMER inputs
  [6:0] INP — Input number for CTIMER3
    {v}=CT_IPN{v-1} input is selected (v=1..20); 21=USB0 usb0 start of frame input is selected; {v}=AOI0_OUT{v-22} input is selected (v=22..25); 26=ADC0_tcomp[0]; 27=ADC0_tcomp[1]; 28=ADC0_tcomp[2]; 29=ADC0_tcomp[3] input is selected; 30=CMP0_OUT is selected; 31=CMP1_OUT is selected; 33=CTimer0_MAT1 input is selected; 34=CTimer0_MAT2 input is selected; 35=CTimer0_MAT3 input is selected; 36=CTimer1_MAT1 input is selected; 37=CTimer1_MAT2 input is selected; 38=CTimer1_MAT3 input is selected; 39=QDC0_CMP_FLAG0 is selected; 40=QDC0_CMP_FLAG1 input is selected; 41=QDC0_CMP_FLAG2 input is selected; 42=QDC0_CMP_FLAG3 input is selected; 43=QDC0_POS_MATCH0 input is selected; 44=PWM0_SM0_MUX_TRIG0 input is selected; 45=PWM0_SM1_MUX_TRIG0 input is selected; 46=PWM0_SM2_MUX_TRIG0 input is selected; 48=LPI2C0 Master End of Packet input is selected; 49=LPI2C0 Slave End of Packet input is selected; 50=LPI2C1 Master End of Packet input is selected; 51=LPI2C1 Slave End of Packet input is selected; 52=LPSPI0 End of Frame input is selected; 53=LPSPI0 Received Data Word input is selected; 54=LPSPI1 End of Frame input is selected; 55=LPSPI1 Received Data Word input is selected; 56=LPUART0 Received Data Word input is selected; 57=LPUART0 Transmitted Data Word input is selected; 58=LPUART0 Receive Line Idle input is selected; 59=LPUART1 Received Data Word input is selected; 60=LPUART1 Transmitted Data Word input is selected; 61=LPUART1 Receive Line Idle input is selected; 62=LPUART2 Received Data Word input is selected; 63=LPUART2 Transmitted Data Word input is selected; 64=LPUART2 Receive Line Idle input is selected; 65=LPUART3 Received Data Word input is selected; 66=LPUART3 Transmitted Data Word input is selected; 67=LPUART3 Receive Line Idle input is selected; 68=LPUART4 Received Data Word input is selected; 69=LPUART4 Transmitted Data Word input is selected; 70=LPUART4 Receive Line Idle input is selected; {v}=AOI1_OUT{v-71} input is selected (v=71..74); {v}=ADC1_tcomp[{v-75}] input is selected (v=75..78); 79=CTimer2_MAT1 input is selected; 80=CTimer2_MAT2 input is selected; 81=CTimer2_MAT3 input is selected; 82=CTimer4_MAT1 input is selected; 83=CTimer4_MAT2 input is selected; 84=CTimer4_MAT3 input is selected; {v}=QDC1_CMP_FLAG{v-85} input is selected (v=85..88); 89=QDC1_POS_MATCH0 input is selected; 90=PWM1_SM0_MUX_TRIG0 input is selected; 91=PWM1_SM1_MUX_TRIG0 input is selected; 92=PWM1_SM2_MUX_TRIG0 input is selected; 94=LPI2C2 Master End of Packet input is selected; 95=LPI2C2 Slave End of Packet input is selected; 96=LPI2C3 Master End of Packet input is selected; 97=LPI2C3 Slave End of Packet input is selected
0x1B0 TIMER3TRIG reset 0x7F — Trigger register for TIMER3
  fields as CTIMER3CAP[0]
{0x1C0+4i} CTIMER4CAP[{i}] (i=0..3) reset 0x7F — Capture select register for CTIMER inputs
  [6:0] INP — Input number for CTIMER4
    {v}=CT_IPN{v-1} input is selected (v=1..20); 21=USB0 usb0 start of frame input is selected; {v}=AOI0_OUT{v-22} input is selected (v=22..25); 26=ADC0_tcomp[0]; 27=ADC0_tcomp[1]; 28=ADC0_tcomp[2]; 29=ADC0_tcomp[3] input is selected; 30=CMP0_OUT is selected; 31=CMP1_OUT is selected; 33=CTimer0_MAT1 input is selected; 34=CTimer0_MAT2 input is selected; 35=CTimer0_MAT3 input is selected; 36=CTimer1_MAT1 input is selected; 37=CTimer1_MAT2 input is selected; 38=CTimer1_MAT3 input is selected; 39=QDC0_CMP_FLAG0 is selected; 40=QDC0_CMP_FLAG1 input is selected; 41=QDC0_CMP_FLAG2 input is selected; 42=QDC0_CMP_FLAG3 input is selected; 43=QDC0_POS_MATCH0 input is selected; 44=PWM0_SM0_MUX_TRIG0 input is selected; 45=PWM0_SM1_MUX_TRIG0 input is selected; 46=PWM0_SM2_MUX_TRIG0 input is selected; 48=LPI2C0 Master End of Packet input is selected; 49=LPI2C0 Slave End of Packet input is selected; 50=LPI2C1 Master End of Packet input is selected; 51=LPI2C1 Slave End of Packet input is selected; 52=LPSPI0 End of Frame input is selected; 53=LPSPI0 Received Data Word input is selected; 54=LPSPI1 End of Frame input is selected; 55=LPSPI1 Received Data Word input is selected; 56=LPUART0 Received Data Word input is selected; 57=LPUART0 Transmitted Data Word input is selected; 58=LPUART0 Receive Line Idle input is selected; 59=LPUART1 Received Data Word input is selected; 60=LPUART1 Transmitted Data Word input is selected; 61=LPUART1 Receive Line Idle input is selected; 62=LPUART2 Received Data Word input is selected; 63=LPUART2 Transmitted Data Word input is selected; 64=LPUART2 Receive Line Idle input is selected; 65=LPUART3 Received Data Word input is selected; 66=LPUART3 Transmitted Data Word input is selected; 67=LPUART3 Receive Line Idle input is selected; 68=LPUART4 Received Data Word input is selected; 69=LPUART4 Transmitted Data Word input is selected; 70=LPUART4 Receive Line Idle input is selected; {v}=AOI1_OUT{v-71} input is selected (v=71..74); {v}=ADC1_tcomp[{v-75}] input is selected (v=75..78); 79=CTimer2_MAT1 input is selected; 80=CTimer2_MAT2 input is selected; 81=CTimer2_MAT3 input is selected; 82=CTimer3_MAT1 input is selected; 83=CTimer3_MAT2 input is selected; 84=CTimer3_MAT3 input is selected; {v}=QDC1_CMP_FLAG{v-85} input is selected (v=85..88); 89=QDC1_POS_MATCH0 input is selected; 90=PWM1_SM0_MUX_TRIG0 input is selected; 91=PWM1_SM1_MUX_TRIG0 input is selected; 92=PWM1_SM2_MUX_TRIG0 input is selected; 94=LPI2C2 Master End of Packet input is selected; 95=LPI2C2 Slave End of Packet input is selected; 96=LPI2C3 Master End of Packet input is selected; 97=LPI2C3 Slave End of Packet input is selected
0x1D0 TIMER4TRIG reset 0x7F — Trigger register for TIMER4
  fields as CTIMER4CAP[0]
{0x200+4i} AOI1_INPUT[{i}] (i=0..15) reset 0x7F — AOI1 trigger input connections 0
  [6:0] INP — AOI0 trigger input connections
    {v}=ADC0_tcomp[{v-1}] input is selected (v=1..4); 5=CMP0_OUT input is selected; 6=CMP1_OUT input is selected; {v}=CTimer0_MAT{v-8} input is selected (v=8..11); 12=CTimer1_MAT0; 13=CTimer1_MAT1 input is selected; 14=CTimer1_MAT2 input is selected; 15=CTimer1_MAT3 input is selected; {v}=CTimer2_MAT{v-16} input is selected (v=16..19); 20=LPTMR0 input is selected; {v}=QDC0_CMP_FLAG{v-22} input is selected (v=22..25); 26=QDC0_POS_MATCH input is selected; 27=PWM0_SM0_MUX_TRIG0 0 input is selected; 28=PWM0_SM0_MUX_TRIG1 input is selected; 29=PWM0_SM1_MUX_TRIG0 input is selected; 30=PWM0_SM1_MUX_TRIG1 input is selected; 31=PWM0_SM2_MUX_TRIG0 input is selected; 32=PWM0_SM2_MUX_TRIG1 input is selected; {v}=TRIG_IN{v-35} input is selected (v=35..46); {v}=GPIO{v-47} Pin Event Trig 0 input is selected (v=47..51); {v}=ADC1_tcomp[{v-52}] input is selected (v=52..55); {v}=CTimer3_MAT{v-56} input is selected (v=56..59); {v}=CTimer4_MAT{v-60} input is selected (v=60..63); {v}=FlexIO CH{v-64} input is selected (v=64..67); {v}=QDC1_CMP_FLAG{v-68} input is selected (v=68..71); 72=QDC1_POS_MATCH0 input is selected; 73=PWM1_SM0_MUX_TRIG0 input is selected; 74=PWM1_SM0_MUX_TRIG1 input is selected; 75=PWM1_SM1_MUX_TRIG0 input is selected; 76=PWM1_SM1_MUX_TRIG1 input is selected; 77=PWM1_SM2_MUX_TRIG0 input is selected; 78=PWM1_SM2_MUX_TRIG1 input is selected
0x260 CMP0_TRIG reset 0x3F — CMP0 input connections
  [5:0] TRIGIN — CMP0 input trigger
    {v}=AOI0_OUT{v-2} input is selected (v=2..5); 6=CMP1_OUT input is selected; 8=CTimer0_MAT0 input is selected; 9=CTimer0_MAT2 input is selected; 10=CTimer1_MAT0; 11=CTimer1_MAT2 input is selected; 12=CTimer2_MAT0 input is selected; 13=CTimer2_MAT2 input is selected; 14=LPTMR0 input is selected; 16=QDC0_POS_MATCH0; 17=PWM0_SM0_MUX_TRIG0 input is selected; 18=PWM0_SM0_MUX_TRIG1 input is selected; 19=PWM0_SM1_MUX_TRIG0 input is selected; 20=PWM0_SM1_MUX_TRIG1 input is selected; 21=PWM0_SM2_MUX_TRIG0 input is selected; 22=PWM0_SM2_MUX_TRIG1 input is selected; {v}=GPIO{v-25} Pin Event Trig 0 input is selected (v=25..29); 30=WUU input is selected; {v}=AOI1_OUT{v-31} input is selected (v=31..34); 39=CTimer3_MAT0; 40=CTimer3_MAT1; 41=CTimer4_MAT0 input is selected; 42=CTimer4_MAT1 input is selected; 47=QDC1_POS_MATCH0 input is selected; 48=PWM1_SM0_MUX_TRIG0 input is selected; 49=PWM1_SM0_MUX_TRIG1 input is selected; 50=PWM1_SM1_MUX_TRIG0 input is selected; 51=PWM1_SM1_MUX_TRIG1 input is selected; 52=PWM1_SM2_MUX_TRIG0 input is selected; 53=PWM1_SM2_MUX_TRIG1 input is selected
{0x280+4i} ADC0_TRIG[{i}] (i=0..3) reset 0x3F — ADC Trigger input connections
  [5:0] TRIGIN — ADC0 trigger inputs
    1=ARM_TXEV input is selected; {v}=AOI0_OUT{v-2} input is selected (v=2..5); 6=CMP0_OUT input is selected; 7=CMP1_OUT input is selected; 9=CTimer0_MAT0 input is selected; 10=CTimer0_MAT1 input is selected; 11=CTimer1_MAT0 input is selected; 12=CTimer1_MAT1 input is selected; 13=CTimer2_MAT0 input is selected; 14=CTimer2_MAT1 input is selected; 15=LPTMR0 input is selected; 17=QDC0_POS_MATCH0 input is selected; 18=PWM0_SM0_OUT_TRIG0 input is selected; 19=PWM0_SM0_OUT_TRIG1 input is selected; 20=PWM0_SM1_OUT_TRIG0 input is selected; 21=PWM0_SM1_OUT_TRIG1 input is selected; 22=PWM0_SM2_OUT_TRIG0 input is selected; 23=PWM0_SM2_OUT_TRIG1 input is selected; {v}=GPIO{v-26} Pin Event Trig 0 input is selected (v=26..30); 31=WUU; {v}=AOI1_OUT{v-33} input is selected (v=33..36); {v}=ADC1_tcomp[{v-37}] input is selected (v=37..40); 41=CTimer3_MAT0 input is selected; 42=CTimer3_MAT1 input is selected; 43=CTimer4_MAT0 input is selected; 44=CTimer4_MAT1 input is selected; {v}=FlexIO CH{v-45} input is selected (v=45..48); 49=QDC1_POS_MATCH0 input is selected; 50=PWM1_SM0_MUX_TRIG0 input is selected; 51=PWM1_SM0_MUX_TRIG1 input is selected; 52=PWM1_SM1_MUX_TRIG0 input is selected; 53=PWM1_SM1_MUX_TRIG1 input is selected; 54=PWM1_SM2_MUX_TRIG0 input is selected; 55=PWM1_SM2_MUX_TRIG1 input is selected
{0x2C0+4i} ADC1_TRIG[{i}] (i=0..3) reset 0x3F — ADC Trigger input connections
  [5:0] TRIGIN — ADC0 trigger inputs
    1=ARM_TXEV input is selected; {v}=AOI0_OUT{v-2} input is selected (v=2..5); 6=CMP0_OUT input is selected; 7=CMP1_OUT input is selected; 9=CTimer0_MAT0 input is selected; 10=CTimer0_MAT1 input is selected; 11=CTimer1_MAT0 input is selected; 12=CTimer1_MAT1 input is selected; 13=CTimer2_MAT0 input is selected; 14=CTimer2_MAT1 input is selected; 15=LPTMR0 input is selected; 17=QDC0_POS_MATCH0 input is selected; 18=PWM0_SM0_OUT_TRIG0 input is selected; 19=PWM0_SM0_OUT_TRIG1 input is selected; 20=PWM0_SM1_OUT_TRIG0 input is selected; 21=PWM0_SM1_OUT_TRIG1 input is selected; 22=PWM0_SM2_OUT_TRIG0 input is selected; 23=PWM0_SM2_OUT_TRIG1 input is selected; {v}=GPIO{v-26} Pin Event Trig 0 input is selected (v=26..30); 31=WUU; {v}=AOI1_OUT{v-33} input is selected (v=33..36); {v}=ADC0_tcomp[{v-37}] input is selected (v=37..40); 41=CTimer3_MAT0 input is selected; 42=CTimer3_MAT1 input is selected; 43=CTimer4_MAT0 input is selected; 44=CTimer4_MAT1 input is selected; {v}=FlexIO CH{v-45} input is selected (v=45..48); 49=QDC1_POS_MATCH0 input is selected; 50=PWM1_SM0_MUX_TRIG0 input is selected; 51=PWM1_SM0_MUX_TRIG1 input is selected; 52=PWM1_SM1_MUX_TRIG0 input is selected; 53=PWM1_SM1_MUX_TRIG1 input is selected; 54=PWM1_SM2_MUX_TRIG0 input is selected; 55=PWM1_SM2_MUX_TRIG1 input is selected
0x300 DAC0_TRIG reset 0x3F — This register selects the DAC0 trigger inputs.
  [5:0] TRIGIN — DAC0 trigger input
    1=ARM_TXEV; {v}=AOI0_OUT{v-2} input is selected (v=2..5); 6=CMP0_OUT input is selected; 7=CMP1_OUT input is selected; 9=CTimer0_MAT0 input is selected; 10=CTimer0_MAT1 input is selected; 11=CTimer1_MAT0 input is selected; 12=CTimer1_MAT1 input is selected; 13=CTimer2_MAT0 input is selected; 14=CTimer2_MAT1 input is selected; 15=LPTMR0 input is selected; {v}=GPIO{v-26} Pin Event Trig 0 input is selected (v=26..30); 31=WUU input is selected; {v}=AOI1_OUT{v-33} input is selected (v=33..36); 37=ADC0_tcomp[0] input is selected; 38=ADC0_tcomp[1] input is selected; 39=ADC1_tcomp[0] input is selected; 40=ADC1_tcomp[1] input is selected; 41=CTimer3_MAT0 input is selected; 42=CTimer3_MAT1 input is selected; 43=CTimer4_MAT0 input is selected; 44=CTimer4_MAT1 input is selected
0x360 QDC0_TRIG reset 0x7F — QDC0 Trigger Input Connections
  [6:0] INP — QDC0 input connections
    1=ARM_TXEV input is selected; {v}=AOI0_OUT{v-2} input is selected (v=2..5); 6=CMP0_OUT input is selected; 7=CMP1_OUT input is selected; 9=CTimer0_MAT2 input is selected; 10=CTimer0_MAT3; 11=CTimer1_MAT2 input is selected; 12=CTimer1_MAT3 input is selected; 13=CTimer2_MAT2 input is selected; 14=CTimer2_MAT3 input is selected; 16=PWM0_SM0_MUX_TRIG0 input is selected; 17=PWM0_SM0_MUX_TRIG1 input is selected; 18=PWM0_SM1_MUX_TRIG0 input is selected; 19=PWM0_SM1_MUX_TRIG1 input is selected; 20=PWM0_SM2_MUX_TRIG0 input is selected; 21=PWM0_SM2_MUX_TRIG1 input is selected; {v}=TRIG_IN{v-24} input is selected (v=24..35); 36=GPIO0 Pin Event Trig 0 is selected; {v}=GPIO{v-36} Pin Event Trig 0 input is selected (v=37..40); {v}=AOI1_OUT{v-41} input is selected (v=41..44); 49=CTimer3_MAT2 input is selected; 50=CTimer3_MAT3 input is selected; 51=CTimer4_MAT2 input is selected; 52=CTimer4_MAT3 End of Frame input is selected; 62=PWM1_SM0_OUT_TRIG0 input is selected; 63=PWM1_SM0_OUT_TRIG1 input is selected; 64=PWM1_SM1_OUT_TRIG0 input is selected; 65=PWM1_SM1_OUT_TRIG1 input is selected; 66=PWM1_SM2_OUT_TRIG0 input is selected; 67=PWM1_SM2_OUT_TRIG1 input is selected
0x364 QDC0_HOME reset 0x7F — QDC0 Trigger Input Connections
  fields as QDC0_TRIG
0x368 QDC0_INDEX reset 0x7F — QDC0 Trigger Input Connections
  fields as QDC0_TRIG
0x36C QDC0_PHASEB reset 0x7F — QDC0 Trigger Input Connections
  fields as QDC0_TRIG
0x370 QDC0_PHASEA reset 0x7F — QDC0 Trigger Input Connections
  fields as QDC0_TRIG
{0x370+4i} QDC0_ICAP{i} reset 0x7F (i=1..3) — QDC0 Trigger Input Connections
  fields as QDC0_TRIG
0x380 QDC1_TRIG reset 0x7F — QDC1 Trigger Input Connections
  [6:0] INP — QDC1 input connections
    values as QDC0_TRIG.INP
0x384 QDC1_HOME reset 0x7F — QDC1 Trigger Input Connections
  fields as QDC1_TRIG
0x388 QDC1_INDEX reset 0x7F — QDC1 Trigger Input Connections
  fields as QDC1_TRIG
0x38C QDC1_PHASEB reset 0x7F — QDC1 Trigger Input Connections
  fields as QDC1_TRIG
0x390 QDC1_PHASEA reset 0x7F — QDC1 Trigger Input Connections
  fields as QDC0_TRIG
{0x390+4i} QDC1_ICAP{i} reset 0x7F (i=1..3) — QDC1 Trigger Input Connections
  fields as QDC1_TRIG
0x3A0 FlexPWM0_SM0_EXTA0 reset 0x3F — PWM0 input trigger connections
  [5:0] TRIGIN — EXTA input connections for PWM0
    1=ARM_TXEV input is selected; {v}=AOI0_OUT{v-2} input is selected (v=2..5); 6=CMP0_OUT input is selected; 7=CMP1_OUT input is selected; 9=CTimer0_MAT2 input is selected; 10=CTimer0_MAT3 input is selected; 11=CTimer1_MAT2 input is selected; 12=CTimer1_MAT3 input is selected; 13=CTimer2_MAT2 input is selected; 14=CTimer2_MAT3 input is selected; {v}=QDC0_CMP_FLAG{v-15} input is selected (v=15..18); 19=QDC0_POS_MATCH0 input is selected; {v}=TRIG_IN{v-20} input is selected (v=20..31); {v}=GPIO{v-32} Pin Event Trig 0 input is selected (v=32..36); {v}=AOI1_OUT{v-37} input is selected (v=37..40); 45=CTimer3_MAT2 input is selected; 46=CTimer3_MAT3 input is selected; 47=CTimer4_MAT2 input is selected; 48=CTimer4_MAT3 input is selected; {v}=QDC1_CMP_FLAG{v-49} input is selected (v=49..52); 53=QDC1_POS_MATCH0 input is selected; 54=PWM1_SM0_MUX_TRIG0 input is selected; 55=PWM1_SM0_MUX_TRIG1 input is selected; 56=PWM1_SM1_MUX_TRIG0 input is selected; 57=PWM1_SM1_MUX_TRIG1 input is selected; 58=PWM1_SM2_MUX_TRIG0 input is selected; 59=PWM1_SM2_MUX_TRIG1 input is selected
{0x3A4+8i} FlexPWM0_SM{i}_EXTSYNC reset 0x3F (i=0..2) — PWM0 input trigger connections
  [5:0] TRIGIN — EXTSYNC input connections for PWM0
    values as FlexPWM0_SM0_EXTA0.TRIGIN
0x3A8 FlexPWM0_SM1_EXTA reset 0x3F — PWM0 input trigger connections
  fields as FlexPWM0_SM0_EXTA0
0x3B0 FlexPWM0_SM2_EXTA reset 0x3F — PWM0 input trigger connections
  fields as FlexPWM0_SM0_EXTA0
{0x3C0+4i} FlexPWM0_FAULT[{i}] (i=0..3) reset 0x3F — PWM0 Fault Input Trigger Connections
  [5:0] TRIGIN — FAULT input connections for PWM0
    values as FlexPWM0_SM0_EXTA0.TRIGIN
0x3D0 FlexPWM0_FORCE reset 0x3F — PWM0 input trigger connections
  [5:0] TRIGIN — Trigger input connections for PWM0
    values as FlexPWM0_SM0_EXTA0.TRIGIN
0x3E0 FlexPWM1_SM0_EXTA0 reset 0x3F — PWM1 input trigger connections
  [5:0] TRIGIN — EXTA input connections for PWM0
    1=ARM_TXEV input is selected; {v}=AOI0_OUT{v-2} input is selected (v=2..5); 6=CMP0_OUT input is selected; 7=CMP1_OUT input is selected; 9=CTimer0_MAT2 input is selected; 10=CTimer0_MAT3 input is selected; 11=CTimer1_MAT2 input is selected; 12=CTimer1_MAT3 input is selected; 13=CTimer2_MAT2 input is selected; 14=CTimer2_MAT3 input is selected; {v}=QDC0_CMP_FLAG{v-15} input is selected (v=15..18); 19=QDC0_POS_MATCH0 input is selected; {v}=TRIG_IN{v-20} input is selected (v=20..31); {v}=GPIO{v-32} Pin Event Trig 0 input is selected (v=32..36); {v}=AOI1_OUT{v-37} input is selected (v=37..40); 45=CTimer3_MAT2 input is selected; 46=CTimer3_MAT3 input is selected; 47=CTimer4_MAT2 input is selected; 48=CTimer4_MAT3 input is selected; {v}=QDC1_CMP_FLAG{v-49} input is selected (v=49..52); 53=QDC1_POS_MATCH0 input is selected; 54=PWM0_SM0_MUX_TRIG0 input is selected; 55=PWM0_SM0_MUX_TRIG1 input is selected; 56=PWM0_SM1_MUX_TRIG0 input is selected; 57=PWM0_SM1_MUX_TRIG1 input is selected; 58=PWM0_SM2_MUX_TRIG0 input is selected; 59=PWM0_SM2_MUX_TRIG1 input is selected
{0x3E4+8i} FlexPWM1_SM{i}_EXTSYNC reset 0x3F (i=0..2) — PWM1 input trigger connections
  [5:0] TRIGIN — EXTSYNC input connections for PWM0
    values as FlexPWM1_SM0_EXTA0.TRIGIN
0x3E8 FlexPWM1_SM1_EXTA reset 0x3F — PWM1 input trigger connections
  fields as FlexPWM1_SM0_EXTA0
0x3F0 FlexPWM1_SM2_EXTA reset 0x3F — PWM1 input trigger connections
  fields as FlexPWM1_SM0_EXTA0
{0x400+4i} FlexPWM1_FAULT[{i}] (i=0..3) reset 0x3F — PWM1 Fault Input Trigger Connections
  [5:0] TRIGIN — FAULT input connections for PWM1
    values as FlexPWM1_SM0_EXTA0.TRIGIN
0x410 FlexPWM1_FORCE reset 0x3F — PWM1 input trigger connections
  [5:0] TRIGIN — Trigger input connections for PWM1
    values as FlexPWM1_SM0_EXTA0.TRIGIN
0x420 PWM0_EXT_CLK reset 0xF — PWM0 external clock trigger
  [3:0] TRIGIN — Trigger input connections for PWM
    1=clk_16k[1] input is selected; 2=clk_in input is selected; 3=AOI0_OUT0 input is selected; 4=AOI0_OUT1 input is selected; 5=EXTTRIG_IN0 input is selected; 6=EXTTRIG_IN7 input is selected; 7=AOI1_OUT0 input is selected; 8=AOI1_OUT1 input is selected
0x424 PWM1_EXT_CLK reset 0xF — PWM1 external clock trigger
  fields as PWM0_EXT_CLK
{0x440+4i} AOI0_INPUT[{i}] (i=0..15) reset 0x7F — AOI0 trigger input connections 0
  fields as AOI1_INPUT[0]
0x480 USBFS_TRIG reset 0x7 — USB-FS trigger input connections
  [3:0] INP — USB-FS trigger input connections.
    {v}=LPUART{v-1} lpuart_trg_txdata input is selected (v=1..4); 5=LPUART4 lpuart_trg_txda input is selected
0x4C0 EXT_TRIG0 reset 0x1F — EXT trigger connections 0
  [4:0] INP — EXT trigger input connections
    {v}=AOI0_OUT{v-2} input is selected (v=2..5); 6=CMP0_OUT input is selected; 7=CMP1_OUT input is selected; {v}=LPUART{v-9} input is selected (v=9..13); {v}=AOI1_OUT{v-14} input is selected (v=14..17)
0x4E0 CMP1_TRIG reset 0x3F — CMP1 input connections
  [5:0] TRIGIN — CMP0 input trigger
    {v}=AOI0_OUT{v-2} input is selected (v=2..5); 6=CMP0_OUT input is selected; 8=CTimer0_MAT0 input is selected; 9=CTimer0_MAT2 input is selected; 10=CTimer1_MAT0; 11=CTimer1_MAT2 input is selected; 12=CTimer2_MAT0 input is selected; 13=CTimer2_MAT2 input is selected; 14=LPTMR0 input is selected; 16=QDC0_POS_MATCH0; 17=PWM0_SM0_MUX_TRIG0 input is selected; 18=PWM0_SM0_MUX_TRIG1 input is selected; 19=PWM0_SM1_MUX_TRIG0 input is selected; 20=PWM0_SM1_MUX_TRIG1 input is selected; 21=PWM0_SM2_MUX_TRIG0 input is selected; 22=PWM0_SM2_MUX_TRIG1 input is selected; {v}=GPIO{v-25} Pin Event Trig 0 input is selected (v=25..29); 30=WUU input is selected; {v}=AOI1_OUT{v-31} input is selected (v=31..34); 39=CTimer3_MAT0; 40=CTimer3_MAT1; 41=CTimer4_MAT0 input is selected; 42=CTimer4_MAT1 input is selected; 47=QDC1_POS_MATCH0 input is selected; 48=PWM1_SM0_MUX_TRIG0 input is selected; 49=PWM1_SM0_MUX_TRIG1 input is selected; 50=PWM1_SM1_MUX_TRIG0 input is selected; 51=PWM1_SM1_MUX_TRIG1 input is selected; 52=PWM1_SM2_MUX_TRIG0 input is selected; 53=PWM1_SM2_MUX_TRIG1 input is selected
0x540 LPI2C2_TRIG reset 0x3F — LPI2C2 trigger input connections
  [5:0] INP
    {v}=AOI0_OUT{v-2} input is selected (v=2..5); 6=CMP0_OUT input is selected; 7=CMP1_OUT input is selected; 9=CTimer0_MAT0 input is selected; 10=CTimer0_MAT1 input is selected; 11=CTimer1_MAT0 input is selected; 12=CTimer1_MAT1 input is selected; 13=CTimer2_MAT0 input is selected; 14=CTimer2_MAT1 input is selected; 15=LPTMR0 input is selected; {v}=TRIG_IN{v-17} input is selected (v=17..24); {v}=GPIO{v-25} Pin Event Trig 0 input is selected (v=25..29); 30=WUU input is selected; {v}=AOI1_OUT{v-31} input is selected (v=31..34); 35=CTimer3_MAT2 input is selected; 36=CTimer3_MAT3 input is selected; 37=CTimer4_MAT2 input is selected; 38=CTimer4_MAT3 input is selected; {v}=FlexIO CH{v-39} input is selected (v=39..42)
0x580 OPAMP0_TRIG reset 0x3F — OPAMP0 Trigger Input Connections
  [5:0] INP — DAC0 trigger input
    {v}=AOI0_OUT{v-2} input is selected (v=2..5); 6=CMP0_OUT input is selected; 7=CMP1_OUT input is selected; 9=CTimer0_MAT0 input is selected; 10=CTimer0_MAT1 input is selected; 11=CTimer1_MAT0 input is selected; 12=CTimer1_MAT1 input is selected; 13=CTimer2_MAT0 input is selected; 14=CTimer2_MAT1 input is selected; 15=LPTMR0 input is selected; 18=PWM0_SM0_MUX_TRIG0 input is selected; 19=PWM0_SM0_MUX_TRIG1 input is selected; 20=PWM0_SM1_MUX_TRIG0 input is selected; 21=PWM0_SM1_MUX_TRIG1 input is selected; 22=PWM0_SM2_MUX_TRIG0 input is selected; 23=PWM0_SM2_MUX_TRIG1 input is selected; {v}=GPIO{v-26} Pin Event Trig 0 input is selected (v=26..30); 31=WUU input is selected; {v}=AOI1_OUT{v-33} input is selected (v=33..36); 37=ADC0_tcomp[0] input is selected; 38=ADC0_tcomp[1] input is selected; 39=ADC1_tcomp[0] input is selected; 40=ADC1_tcomp[1] input is selected; 41=CTimer3_MAT0 input is selected; 42=CTimer3_MAT1 input is selected; 43=CTimer4_MAT0 input is selected; 44=CTimer4_MAT1 input is selected; {v}=FlexIO CH{v-45} input is selected (v=45..48); 50=PWM1_SM0_MUX_TRIG0 input is selected; 51=PWM1_SM0_MUX_TRIG1 input is selected; 52=PWM1_SM1_MUX_TRIG0 input is selected; 53=PWM1_SM1_MUX_TRIG1 input is selected; 54=PWM1_SM2_MUX_TRIG0 input is selected; 55=PWM1_SM2_MUX_TRIG1 input is selected
0x5A0 LPI2C0_TRIG reset 0x3F — LPI2C0 trigger input connections
  fields as LPI2C2_TRIG
0x5C0 LPI2C1_TRIG reset 0x3F — LPI2C1 trigger input connections
  fields as LPI2C2_TRIG
0x5E0 LPSPI0_TRIG reset 0x3F — LPSPI0 trigger input connections
  [5:0] INP
    {v}=AOI0_OUT{v-2} input is selected (v=2..5); 6=CMP0_OUT input is selected; 7=CMP1_OUT input is selected; 9=CTimer0_MAT1 input is selected; 10=CTimer0_MAT2 input is selected; 11=CTimer1_MAT1 input is selected; 12=CTimer1_MAT2 input is selected; 13=CTimer2_MAT1 input is selected; 14=CTimer2_MAT2 input is selected; 15=LPTMR0 input is selected; {v}=TRIG_IN{v-17} input is selected (v=17..24); {v}=GPIO{v-25} Pin Event Trig 0 input is selected (v=25..29); 30=WUU input is selected; {v}=AOI1_OUT{v-31} input is selected (v=31..34); 35=CTimer3_MAT2 input is selected; 36=CTimer3_MAT3 input is selected; 37=CTimer4_MAT2 input is selected; 38=CTimer4_MAT3 input is selected; {v}=FlexIO CH{v-39} input is selected (v=39..42)
0x600 LPSPI1_TRIG reset 0x3F — LPSPI1 trigger input connections
  fields as LPSPI0_TRIG
{0x620+0x20*i} LPUART{i} reset 0x3F (i=0..4) — LPUART{i} trigger input connections
  [5:0] INP
    {v}=AOI0_OUT{v-2} input is selected (v=2..5); 6=CMP0_OUT input is selected; 7=CMP1_OUT input is selected; 9=CTimer0_MAT2 input is selected; 10=CTimer0_MAT3 input is selected; 11=CTimer1_MAT2 input is selected; 12=CTimer1_MAT3 input is selected; 13=CTimer2_MAT2 input is selected; 14=CTimer2_MAT3 input is selected; 15=LPTMR0 input is selected; {v}=TRIG_IN{v-17} input is selected (v=17..28); {v}=GPIO{v-29} Pin Event Trig 0 input is selected (v=29..33); 34=WUU selected; 35=USB0 ipp_ind_uart_rxd_usbmux input is selected; {v}=AOI1_OUT{v-36} input is selected (v=36..39); 40=CTimer3_MAT2 input is selected; 41=CTimer3_MAT3 input is selected; 42=CTimer4_MAT2 input is selected; 43=CTimer4_MAT3 input is selected; {v}=FlexIO CH{v-44} input is selected (v=44..47)
{0x6E0+4i} FLEXIO_TRIG[{i}] (i=0..3) reset 0x7F — FlexIO Trigger Input Connections
  [6:0] INP — Input number for FlexIO0.
    {v}=AOI0_OUT{v-1} input is selected (v=1..4); {v}=ADC0_tcomp[{v-5}] input is selected (v=5..8); 9=CMP0_OUT input is selected; 10=CMP1_OUT input is selected; 12=CTimer0_MAT1 input is selected; 13=CTimer0_MAT2 input is selected; 14=CTimer1_MAT1 input is selected; 15=CTimer1_MAT2 input is selected; 16=CTimer2_MAT1 input is selected; 17=CTimer2_MAT2 input is selected; 18=LPTMR0 input is selected; 20=PWM0_SM0_MUX_TRIG0 input is selected; 21=PWM0_SM1_MUX_TRIG0 input is selected; 22=PWM0_SM2_MUX_TRIG0 input is selected; {v}=TRIG_IN{v-24} input is selected (v=24..31); 32=GPIO0 Pin Event Trig 0 input is selected; 33=GPIO2 Pin Event Trig 0 input is selected; 34=GPIO3 Pin Event Trig 0 input is selected; 35=GPIO4 Pin Event Trig 0 input is selected; 36=WUU input is selected; 37=PWM1_A0_TRIG0 input is selected; 38=LPI2C0 Master End of Packet; 39=LPI2C0 Slave End of Packet; 40=LPI2C1 Master End of Packet; 41=LPI2C1 Slave End of Packet; 42=LPSPI0 End of Frame; 43=LPSPI0 Received Data Word; 44=LPSPI1 End of Frame; 45=LPSPI1 Received Data Word; 46=LPUART0 Received Data Word; 47=LPUART0 Transmitted Data Word; 48=LPUART0 Receive Line Idle; 49=LPUART1 Received Data Word; 50=LPUART1 Transmitted Data Word; 51=LPUART1 Receive Line Idle; 52=LPUART2 Received Data Word; 53=LPUART2 Transmitted Data Word; 54=LPUART2 Receive Line Idle; 55=LPUART3 Received Data Word; 56=LPUART3 Transmitted Data Word; 57=LPUART3 Receive Line Idle; 58=LPUART4 Received Data Word; 59=LPUART4 Transmitted Data Word; 60=LPUART4 Receive Line Idle; {v}=AOI1_OUT{v-61} input is selected (v=61..64); {v}=ADC1_tcomp[{v-65}] input is selected (v=65..68); 69=CTimer3_MAT2 input is selected; 70=CTimer3_MAT3 input is selected; 71=CTimer4_MAT2 input is selected; 72=CTimer4_MAT3 input is selected; 73=PWM1_SM0_MUX_TRIG0 input is selected; 74=PWM1_SM1_MUX_TRIG0 input is selected; 75=PWM1_SM2_MUX_TRIG0 input is selected; 77=LPI2C2 Master End of Packet; 78=LPI2C2 Slave End of Packet; 79=LPI2C3 Master End of Packet; 80=LPI2C3 Slave End of Packet
